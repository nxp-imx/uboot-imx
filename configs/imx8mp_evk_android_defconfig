## configs/imx8qm_lpddr4_arm2_defconfig
```kconfig
CONFIG_ARM=y
CONFIG_ARCH_IMX8=y
CONFIG_DEFAULT_DEVICE_TREE="fsl-imx8qm-lpddr4-arm2"
CONFIG_TARGET_IMX8QM_LPDDR4_ARM2=y
CONFIG_CMD_IMPORTENV=n
CONFIG_SYS_MALLOC_F_LEN=0x2000
CONFIG_DM=y
CONFIG_CMD_CACHE=y

CONFIG_DM_SERIAL=y
CONFIG_FSL_LPUART=y
CONFIG_OF_CONTROL=y
CONFIG_DM_I2C=y
# CONFIG_DM_I2C_COMPAT is not set
CONFIG_SYS_I2C_IMX_LPI2C=y
CONFIG_CMD_I2C=y

CONFIG_USB_XHCI_HCD=y
CONFIG_USB_XHCI_IMX8=y

CONFIG_DM_USB=y
CONFIG_USB_EHCI_HCD=y

CONFIG_CMD_USB=y
CONFIG_USB=y
CONFIG_USB_STORAGE=y

CONFIG_CMD_USB_MASS_STORAGE=y
CONFIG_USB_GADGET=y
# CONFIG_CI_UDC=y
CONFIG_USB_GADGET_DOWNLOAD=y
CONFIG_G_DNL_MANUFACTURER="FSL"
CONFIG_G_DNL_VENDOR_NUM=0x0525
CONFIG_G_DNL_PRODUCT_NUM=0xa4a5

CONFIG_USB_CDNS3=y
CONFIG_USB_CDNS3_GADGET=y
CONFIG_USB_GADGET_DUALSPEED=y

CONFIG_CMD_GPIO=y
CONFIG_DM_GPIO=y
CONFIG_DM_PCA953X=y
CONFIG_BOOTDELAY=3
CONFIG_IMX_BOOTAUX=y
CONFIG_CMD_FAT=y
CONFIG_CMD_MMC=y
CONFIG_DM_MMC=y
# CONFIG_BLK is not set
# CONFIG_DM_MMC_OPS is not set
CONFIG_FSL_FSPI=y
CONFIG_DM_SPI=y
CONFIG_DM_SPI_FLASH=y
CONFIG_SPI_FLASH=y
CONFIG_SPI_FLASH_4BYTES_ADDR=y
CONFIG_SPI_FLASH_STMICRO=y
CONFIG_CMD_SF=y

CONFIG_CMD_PING=y
CONFIG_CMD_DHCP=y
CONFIG_CMD_MII=y
CONFIG_DM_ETH=y
# CONFIG_EFI_LOADER is not set

CONFIG_DM_REGULATOR=y
CONFIG_DM_REGULATOR_FIXED=y
CONFIG_DM_REGULATOR_GPIO=y

CONFIG_VIDEO=y
CONFIG_VIDEO_IMX_HDP_LOAD=y

CONFIG_PINCTRL=y
CONFIG_PINCTRL_IMX8=y

CONFIG_POWER_DOMAIN=y
CONFIG_IMX8_POWER_DOMAIN=y

CONFIG_DM_THERMAL=y
CONFIG_IMX_SC_THERMAL=y

CONFIG_SMC_FUSE=y
CONFIG_CMD_MEMTEST=y
```

## configs/imx8qm_mek_androidauto2_trusty_defconfig
```kconfig
CONFIG_ARM=y
CONFIG_ARCH_IMX8=y
CONFIG_SYS_TEXT_BASE=0x80020000
CONFIG_SPL_GPIO_SUPPORT=y
CONFIG_SPL_LIBCOMMON_SUPPORT=y
CONFIG_SPL_LIBGENERIC_SUPPORT=y
CONFIG_SYS_MALLOC_F_LEN=0x8000
CONFIG_TARGET_IMX8QM_MEK=y
CONFIG_SPL_MMC_SUPPORT=y
CONFIG_SPL_EFI_PARTITION=y
CONFIG_SPL_DOS_PARTITION=n
CONFIG_SPL_DM_SEQ_ALIAS=y
CONFIG_SPL_SERIAL_SUPPORT=y
CONFIG_SPL_DRIVERS_MISC_SUPPORT=y
CONFIG_SPL_LIBDISK_SUPPORT=y
CONFIG_USE_TINY_PRINTF=y
CONFIG_SPL=y
CONFIG_PANIC_HANG=y
CONFIG_NR_DRAM_BANKS=4
CONFIG_FIT=y
CONFIG_SYS_EXTRA_OPTIONS="IMX_CONFIG=board/freescale/imx8qm_mek/imximage.cfg,ANDROID_AUTO_SUPPORT"
CONFIG_BOOTDELAY=1
CONFIG_LOG=y
CONFIG_SPL_BOARD_INIT=y
# CONFIG_SPL_SYS_MALLOC_SIMPLE is not set
CONFIG_SPL_SEPARATE_BSS=y
CONFIG_SPL_POWER_SUPPORT=y
CONFIG_SPL_POWER_DOMAIN=y
CONFIG_SPL_WATCHDOG_SUPPORT=y
CONFIG_HUSH_PARSER=y
CONFIG_CMD_CPU=y
CONFIG_CMD_CLK=y
CONFIG_CMD_GPIO=y
CONFIG_CMD_I2C=n
CONFIG_CMD_MMC=y
CONFIG_CMD_DHCP=y
CONFIG_CMD_PING=y
CONFIG_CMD_CACHE=y
CONFIG_CMD_FAT=y
CONFIG_SPL_OF_CONTROL=y
CONFIG_DEFAULT_DEVICE_TREE="fsl-imx8qm-mek-auto2"
CONFIG_ENV_IS_IN_MMC=y
CONFIG_SPL_DM=y
CONFIG_SPL_CLK=y
CONFIG_CLK_IMX8=y
CONFIG_CPU=y
CONFIG_DM_GPIO=y
CONFIG_MXC_GPIO=y
CONFIG_DM_PCA953X=y
CONFIG_DM_I2C=y
CONFIG_SYS_I2C_IMX_LPI2C=y
CONFIG_I2C_MUX=y
CONFIG_I2C_MUX_PCA954x=y
CONFIG_MISC=y
CONFIG_DM_MMC=y
CONFIG_MMC_IO_VOLTAGE=y
CONFIG_MMC_UHS_SUPPORT=y
CONFIG_MMC_HS400_SUPPORT=y
CONFIG_EFI_PARTITION=y
CONFIG_PINCTRL=y
CONFIG_SPL_PINCTRL=y
CONFIG_PINCTRL_IMX8=y
CONFIG_POWER_DOMAIN=y
CONFIG_IMX8_POWER_DOMAIN=y
CONFIG_DM_REGULATOR=y
CONFIG_SPL_DM_REGULATOR=y
CONFIG_DM_REGULATOR_FIXED=y
CONFIG_DM_REGULATOR_GPIO=y
CONFIG_SPL_DM_REGULATOR_FIXED=y
CONFIG_DM_SERIAL=y
CONFIG_FSL_LPUART=y
CONFIG_SPL_TINY_MEMSET=y

CONFIG_CMD_FUSE=y
CONFIG_SMC_FUSE=y
CONFIG_CMD_MEMTEST=y

CONFIG_IMX_TRUSTY_OS=y

CONFIG_DM_THERMAL=y
CONFIG_IMX_SC_THERMAL=y

CONFIG_SPI=y
CONFIG_FSL_FSPI=y
CONFIG_DM_SPI=y
CONFIG_DM_SPI_FLASH=y
CONFIG_SPI_FLASH=y
CONFIG_SPI_FLASH_STMICRO=y
CONFIG_SPI_FLASH_4BYTES_ADDR=y
CONFIG_CMD_SF=y
CONFIG_SF_DEFAULT_BUS=0
CONFIG_SF_DEFAULT_CS=0
CONFIG_SF_DEFAULT_SPEED=40000000
CONFIG_SF_DEFAULT_MODE=0
CONFIG_USB_XHCI_HCD=y
CONFIG_USB_XHCI_IMX8=y

CONFIG_DM_USB=y
CONFIG_DM_USB_GADGET=y
CONFIG_SPL_DM_USB_GADGET=y
CONFIG_USB=y

CONFIG_USB_GADGET=y
#CONFIG_CI_UDC=y
CONFIG_USB_GADGET_DOWNLOAD=y
CONFIG_USB_GADGET_MANUFACTURER="FSL"
CONFIG_USB_GADGET_VENDOR_NUM=0x0525
CONFIG_USB_GADGET_PRODUCT_NUM=0xa4a5
CONFIG_USB_CDNS3=y
CONFIG_USB_CDNS3_GADGET=y
CONFIG_USB_GADGET_DUALSPEED=y

CONFIG_SPL_USB_GADGET=y
CONFIG_SPL_USB_SDP_SUPPORT=y
CONFIG_SPL_SDP_USB_DEV=1
CONFIG_SDP_LOADADDR=0x80400000

CONFIG_FASTBOOT=y
CONFIG_USB_FUNCTION_FASTBOOT=y
CONFIG_CMD_FASTBOOT=y
CONFIG_ANDROID_BOOT_IMAGE=y
CONFIG_FASTBOOT_UUU_SUPPORT=n
CONFIG_FSL_FASTBOOT=y
CONFIG_FASTBOOT_BUF_ADDR=0x98000000
CONFIG_FASTBOOT_BUF_SIZE=0x19000000
CONFIG_FASTBOOT_FLASH=y
CONFIG_FASTBOOT_USB_DEV=1
CONFIG_BOOTAUX_RESERVED_MEM_BASE=0x88000000
CONFIG_BOOTAUX_RESERVED_MEM_SIZE=0x01000000

CONFIG_CMD_NET=n
CONFIG_CMD_NFS=n
CONFIG_CMD_BDI=n
CONFIG_CMD_CONSOLE=n
CONFIG_CMD_BOOTD=n
CONFIG_CMD_BOOTEFI=n
CONFIG_CMD_BOOTEFI_HELLO_COMPILE=n
CONFIG_CMD_ELF=n
CONFIG_CMD_GO=n
CONFIG_CMD_RUN=n
CONFIG_CMD_IMI=n
CONFIG_CMD_IMLS=n
CONFIG_CMD_XIMG=n
CONFIG_CMD_EXPORTENV=n
CONFIG_CMD_IMPORTENV=n
CONFIG_CMD_EDITENV=n
CONFIG_CMD_ENV_EXISTS=n
CONFIG_CMD_CRC32=n
CONFIG_CMD_DM=n
CONFIG_CMD_LOADB=n
CONFIG_CMD_LOADS=n
CONFIG_CMD_FLASH=n
CONFIG_CMD_GPT=n
CONFIG_CMD_FPGA=n
CONFIG_CMD_ECHO=n
CONFIG_CMD_ITEST=n
CONFIG_CMD_SOURCE=n
CONFIG_CMD_SETEXPR=n
CONFIG_CMD_MISC=n
CONFIG_CMD_UNZIP=n
CONFIG_CMD_LZMADEC=n
CONFIG_CMD_SAVEENV=n

CONFIG_DISPLAY_CPUINFO=n
CONFIG_DISPLAY_BOARDINFO=n
CONFIG_EFI_LOADER=n
# CONFIG_SYS_MALLOC_CLEAR_ON_INIT is not set

CONFIG_LZ4=y
CONFIG_APPEND_BOOTARGS=y
CONFIG_LIBAVB=y
CONFIG_SHA256=y
CONFIG_SPL_MMC_WRITE=y
CONFIG_DUAL_BOOTLOADER=y
CONFIG_CMD_MMC_RPMB=y
CONFIG_TRUSTY_UNLOCK_PERMISSION=y
```

## configs/imx8qm_mek_androidauto_defconfig
```kconfig
CONFIG_ARM=y
CONFIG_ARCH_IMX8=y
CONFIG_DEFAULT_DEVICE_TREE="fsl-imx8qm-mek"
CONFIG_SYS_EXTRA_OPTIONS="ANDROID_AUTO_SUPPORT"
CONFIG_TARGET_IMX8QM_MEK=y
CONFIG_EFI_PARTITION=y
CONFIG_CMD_IMPORTENV=n
CONFIG_SYS_MALLOC_F_LEN=0x2000
CONFIG_DM=y
CONFIG_DM_WARN=n
CONFIG_DM_DEVICE_REMOVE=n

CONFIG_DM_SERIAL=y
CONFIG_FSL_LPUART=y
CONFIG_OF_CONTROL=y
CONFIG_DM_I2C=y
# CONFIG_DM_I2C_COMPAT is not set
CONFIG_SYS_I2C_IMX_LPI2C=y
CONFIG_CMD_I2C=y

CONFIG_USB=y
CONFIG_CMD_USB=y
CONFIG_DM_USB=y
CONFIG_USB_XHCI_HCD=y
CONFIG_USB_EHCI_HCD=y
CONFIG_USB_XHCI_IMX8=y
CONFIG_USB_TCPC=y
CONFIG_USB_CDNS3=y
CONFIG_USB_CDNS3_GADGET=y
CONFIG_USB_GADGET_DUALSPEED=y

CONFIG_USB_GADGET=y
#CONFIG_CI_UDC=y
CONFIG_USB_GADGET_DOWNLOAD=y
CONFIG_G_DNL_MANUFACTURER="FSL"
CONFIG_G_DNL_VENDOR_NUM=0x18d1
CONFIG_G_DNL_PRODUCT_NUM=0x0d02

CONFIG_DM_GPIO=y
CONFIG_DM_PCA953X=y
CONFIG_BOOTDELAY=1
CONFIG_CMD_MMC=y
CONFIG_DM_MMC=y
# CONFIG_BLK is not set
# CONFIG_DM_MMC_OPS is not set
CONFIG_FSL_FSPI=y
CONFIG_DM_SPI=y
CONFIG_DM_SPI_FLASH=y
CONFIG_SPI_FLASH=y
CONFIG_SPI_FLASH_4BYTES_ADDR=y
CONFIG_SPI_FLASH_STMICRO=y

CONFIG_DM_REGULATOR=y
CONFIG_DM_REGULATOR_FIXED=y
CONFIG_DM_REGULATOR_GPIO=y

CONFIG_PINCTRL=y
CONFIG_PINCTRL_IMX8=y

CONFIG_CMD_NET=n
CONFIG_CMD_NFS=n
CONFIG_CMD_BDI=n
CONFIG_CMD_CONSOLE=n
CONFIG_CMD_BOOTD=n
CONFIG_CMD_BOOTEFI=n
CONFIG_CMD_BOOTEFI_HELLO_COMPILE=n
CONFIG_CMD_ELF=n
CONFIG_CMD_GO=n
CONFIG_CMD_RUN=n
CONFIG_CMD_IMI=n
CONFIG_CMD_IMLS=n
CONFIG_CMD_XIMG=n
CONFIG_CMD_EXPORTENV=n
CONFIG_CMD_IMPORTENV=n
CONFIG_CMD_EDITENV=n
CONFIG_CMD_ENV_EXISTS=n
CONFIG_CMD_MEMORY=n
CONFIG_CMD_CRC32=n
CONFIG_CMD_DM=n
CONFIG_CMD_LOADB=n
CONFIG_CMD_LOADS=n
CONFIG_CMD_FLASH=n
CONFIG_CMD_GPT=n
CONFIG_CMD_FPGA=n
CONFIG_CMD_ECHO=n
CONFIG_CMD_ITEST=n
CONFIG_CMD_SOURCE=n
CONFIG_CMD_SETEXPR=n
CONFIG_CMD_MISC=n

CONFIG_DISPLAY_CPUINFO=n
CONFIG_DISPLAY_BOARDINFO=n
CONFIG_EFI_LOADER=n

CONFIG_POWER_DOMAIN=y
CONFIG_IMX8_POWER_DOMAIN=y

CONFIG_DM_THERMAL=y
CONFIG_IMX_SC_THERMAL=y

CONFIG_LZ4=y

CONFIG_SMC_FUSE=y
CONFIG_CMD_MEMTEST=y
```

## configs/imx8qm_mek_androidauto_trusty_defconfig
```kconfig
CONFIG_ARM=y
CONFIG_ARCH_IMX8=y
CONFIG_TEXT_BASE=0x80020000
CONFIG_SYS_MALLOC_LEN=0x2400000
CONFIG_SYS_MALLOC_F_LEN=0x8000
CONFIG_SYS_MEMTEST_START=0xA0000000
CONFIG_SYS_MEMTEST_END=0xB0000000
CONFIG_SPL_GPIO=y
CONFIG_SPL_LIBCOMMON_SUPPORT=y
CONFIG_SPL_LIBGENERIC_SUPPORT=y
CONFIG_NR_DRAM_BANKS=4
CONFIG_HAS_CUSTOM_SYS_INIT_SP_ADDR=y
CONFIG_CUSTOM_SYS_INIT_SP_ADDR=0x80200000
CONFIG_ENV_SIZE=0x2000
CONFIG_ENV_OFFSET=0x700000
CONFIG_DM_GPIO=y
CONFIG_DEFAULT_DEVICE_TREE="fsl-imx8qm-mek"
CONFIG_SPL_TEXT_BASE=0x100000
CONFIG_TARGET_IMX8QM_MEK=y
CONFIG_SPL_MMC=y
CONFIG_SPL_EFI_PARTITION=y
CONFIG_SPL_DOS_PARTITION=n
CONFIG_SPL_DM_SEQ_ALIAS=y
CONFIG_SPL_SERIAL=y
CONFIG_SPL_DRIVERS_MISC=y
CONFIG_SPL_STACK=0x13fff0
CONFIG_SPL=y
CONFIG_SPL_LOAD_IMX_CONTAINER=y
CONFIG_IMX_CONTAINER_CFG="board/freescale/imx8qm_mek/uboot-container.cfg"
CONFIG_SYS_LOAD_ADDR=0x80200000
CONFIG_REMAKE_ELF=y
CONFIG_OF_BOARD_SETUP=y
CONFIG_USE_TINY_PRINTF=y
CONFIG_PANIC_HANG=y
CONFIG_OF_SYSTEM_SETUP=y
CONFIG_BOOTDELAY=3
CONFIG_USE_BOOTCOMMAND=y
CONFIG_BOOTCOMMAND="mmc dev ${mmcdev}; if mmc rescan; then if run loadbootscript; then run bootscript; else if test ${sec_boot} = yes; then if run loadcntr; then run mmcboot; else run netboot; fi; else if run loadimage; then run mmcboot; else run netboot; fi; fi; fi; else booti ${loadaddr} - ${fdt_addr}; fi"
CONFIG_LOG=y
CONFIG_BOARD_EARLY_INIT_F=y
CONFIG_SPL_MAX_SIZE=0x30000
CONFIG_SPL_HAS_BSS_LINKER_SECTION=y
CONFIG_SPL_BSS_START_ADDR=0x130000
CONFIG_SPL_BSS_MAX_SIZE=0x1000
CONFIG_SYS_MONITOR_LEN=1048576
CONFIG_SPL_BOARD_INIT=y
# CONFIG_SPL_SYS_MALLOC_SIMPLE is not set
# CONFIG_SPL_SHARES_INIT_SP_ADDR is not set
CONFIG_SYS_SPL_MALLOC=y
CONFIG_HAS_CUSTOM_SPL_MALLOC_START=y
CONFIG_CUSTOM_SYS_SPL_MALLOC_ADDR=0x82200000
CONFIG_SYS_SPL_MALLOC_SIZE=0x80000
CONFIG_SYS_MMCSD_RAW_MODE_U_BOOT_USE_SECTOR=y
CONFIG_SYS_MMCSD_RAW_MODE_U_BOOT_SECTOR=0x1040
CONFIG_SPL_POWER_DOMAIN=y
CONFIG_HUSH_PARSER=y
CONFIG_SYS_CBSIZE=2048
CONFIG_SYS_PBSIZE=2068
CONFIG_SYS_MAXARGS=64
CONFIG_CMD_CPU=y
# CONFIG_BOOTM_NETBSD is not set
# CONFIG_CMD_EXPORTENV is not set
# CONFIG_CMD_IMPORTENV is not set
CONFIG_CMD_CRC32=y
CONFIG_CRC32_VERIFY=y
CONFIG_CMD_CLK=y
CONFIG_CMD_DM=y
CONFIG_CMD_GPIO=y
CONFIG_CMD_I2C=y
CONFIG_CMD_MMC=y
CONFIG_CMD_DHCP=y
CONFIG_CMD_MII=y
CONFIG_CMD_PING=y
CONFIG_CMD_CACHE=y
CONFIG_CMD_EXT2=y
CONFIG_CMD_EXT4=y
CONFIG_CMD_EXT4_WRITE=y
CONFIG_CMD_FAT=y
CONFIG_CMD_USB=y
CONFIG_CMD_USB_MASS_STORAGE=y
CONFIG_SPL_OF_CONTROL=y
CONFIG_ENV_OVERWRITE=y
CONFIG_ENV_IS_IN_MMC=y
CONFIG_SYS_RELOC_GD_ENV_ADDR=y
CONFIG_SYS_MMC_ENV_DEV=1
CONFIG_ENV_VARS_UBOOT_RUNTIME_CONFIG=y
CONFIG_NET_RANDOM_ETHADDR=y
CONFIG_SPL_DM=y
CONFIG_SPL_CLK=y
CONFIG_CLK_IMX8=y
CONFIG_CPU=y
CONFIG_MXC_GPIO=y
CONFIG_DM_PCA953X=y
CONFIG_DM_I2C=y
CONFIG_SYS_I2C_IMX_LPI2C=y
CONFIG_I2C_MUX=y
CONFIG_I2C_MUX_PCA954x=y
CONFIG_SUPPORT_EMMC_BOOT=y
CONFIG_FSL_USDHC=y
CONFIG_MMC_IO_VOLTAGE=y
CONFIG_MMC_UHS_SUPPORT=y
CONFIG_MMC_HS400_SUPPORT=y
CONFIG_EFI_PARTITION=y
CONFIG_PHYLIB=y
CONFIG_PHY_ADDR_ENABLE=y
CONFIG_PHY_ATHEROS=y
CONFIG_PHY_GIGE=y
CONFIG_FEC_MXC_SHARE_MDIO=y
CONFIG_FEC_MXC_MDIO_BASE=0x5B040000
CONFIG_FEC_MXC=y
CONFIG_MII=y
CONFIG_USE_ETHPRIME=y
CONFIG_ETHPRIME="eth0"
CONFIG_PINCTRL=y
CONFIG_SPL_PINCTRL=y
CONFIG_PINCTRL_IMX8=y
CONFIG_POWER_DOMAIN=y
CONFIG_IMX8_POWER_DOMAIN=y
CONFIG_DM_REGULATOR=y
CONFIG_SPL_DM_REGULATOR=y
CONFIG_DM_REGULATOR_FIXED=y
CONFIG_DM_REGULATOR_GPIO=y
CONFIG_SPL_DM_REGULATOR_FIXED=y
CONFIG_DM_SERIAL=y
CONFIG_FSL_LPUART=y
CONFIG_SPL_TINY_MEMSET=y
# CONFIG_EFI_LOADER is not set

CONFIG_CMD_FUSE=y
CONFIG_CMD_MEMTEST=y

CONFIG_IMX_BOOTAUX=y

CONFIG_DM_THERMAL=y
CONFIG_IMX_SCU_THERMAL=y
CONFIG_SPI=y
CONFIG_NXP_FSPI=y
CONFIG_DM_SPI=y
CONFIG_DM_SPI_FLASH=y
CONFIG_SPI_FLASH=y
CONFIG_SPI_FLASH_STMICRO=y
CONFIG_CMD_SF=y
CONFIG_SF_DEFAULT_BUS=0
CONFIG_SF_DEFAULT_CS=0
CONFIG_SF_DEFAULT_SPEED=40000000
CONFIG_SF_DEFAULT_MODE=0

CONFIG_USB_XHCI_HCD=y
CONFIG_USB_XHCI_IMX8=y
CONFIG_DM_USB=y
CONFIG_DM_USB_GADGET=y
CONFIG_SPL_DM_USB_GADGET=y
CONFIG_USB=y
CONFIG_USB_MAX_CONTROLLER_COUNT=2
CONFIG_USB_HOST_ETHER=y
CONFIG_USB_ETHER_ASIX=y
CONFIG_USB_STORAGE=y
CONFIG_USB_TCPC=y
CONFIG_USB_GADGET=y
CONFIG_CI_UDC=y
CONFIG_USB_GADGET_DOWNLOAD=y
CONFIG_USB_GADGET_MANUFACTURER="FSL"
CONFIG_USB_GADGET_VENDOR_NUM=0x1fc9
CONFIG_USB_GADGET_PRODUCT_NUM=0x0152
CONFIG_USB_CDNS3=y
CONFIG_USB_CDNS3_GADGET=y
CONFIG_USB_GADGET_DUALSPEED=y
CONFIG_CDNS3_USB_PHY=y
CONFIG_PHY=y
CONFIG_SPL_PHY=y

CONFIG_SPL_USB_GADGET=y
CONFIG_SPL_USB_SDP_SUPPORT=y
CONFIG_SPL_SDP_USB_DEV=1
CONFIG_SDP_LOADADDR=0x80400000

CONFIG_FASTBOOT=y
CONFIG_USB_FUNCTION_FASTBOOT=y
CONFIG_CMD_FASTBOOT=y
CONFIG_ANDROID_BOOT_IMAGE=y
CONFIG_FASTBOOT_UUU_SUPPORT=n
CONFIG_FASTBOOT_BUF_ADDR=0x98000000
CONFIG_FASTBOOT_BUF_SIZE=0x19000000
CONFIG_FASTBOOT_FLASH=y
CONFIG_FASTBOOT_USB_DEV=1

CONFIG_BOOTAUX_RESERVED_MEM_BASE=0x88800000
CONFIG_BOOTAUX_RESERVED_MEM_SIZE=0x02000000

CONFIG_REGMAP=y
CONFIG_SYSCON=y
CONFIG_AHCI=y
CONFIG_IMX_AHCI=y
CONFIG_DM_SCSI=y
CONFIG_SCSI=y
CONFIG_CMD_SCSI=y

CONFIG_PCI=y
CONFIG_PCIE_IMX=y
CONFIG_PCI_SCAN_SHOW=y
CONFIG_CMD_PCI=y

CONFIG_USB_PORT_AUTO=y

CONFIG_IMX_SNVS_SEC_SC=y

CONFIG_VIDEO_IMX_HDP_LOAD=y
CONFIG_OF_LIBFDT_OVERLAY=y

CONFIG_VIDEO_IMXDPUV1=y
CONFIG_VIDEO=y
CONFIG_BMP_16BPP=y
CONFIG_BMP_24BPP=y
CONFIG_BMP_32BPP=y
CONFIG_VIDEO_LOGO=y
CONFIG_VIDEO_IMX8_LVDS=y
CONFIG_VIDEO_IT6263_BRIDGE=y
CONFIG_SYS_WHITE_ON_BLACK=y
CONFIG_SPLASH_SCREEN=y
CONFIG_SPLASH_SCREEN_ALIGN=y
CONFIG_CMD_BMP=y

CONFIG_LZ4=y
CONFIG_APPEND_BOOTARGS=y
CONFIG_PSCI_BOARD_REBOOT=y
CONFIG_ANDROID_AB_SUPPORT=y
CONFIG_IMX_TRUSTY_OS=y
CONFIG_DUAL_BOOTLOADER=y
CONFIG_SHA256=y
CONFIG_ATTESTATION_ID_BRAND="Android"
CONFIG_ATTESTATION_ID_DEVICE="mek_8q"
CONFIG_ATTESTATION_ID_PRODUCT="mek_8q_car"
CONFIG_ATTESTATION_ID_MANUFACTURER="nxp"
CONFIG_ATTESTATION_ID_MODEL="MEK-MX8Q"
CONFIG_SHA256=y
CONFIG_ANDROID_AUTO_SUPPORT=y
CONFIG_CMD_ERASEENV=y
```

## configs/imx8qm_mek_androidauto_xen_defconfig
```kconfig
CONFIG_ARM=y
CONFIG_ARCH_IMX8=y
CONFIG_DEFAULT_DEVICE_TREE="fsl-imx8qm-mek-xen"
CONFIG_SYS_EXTRA_OPTIONS="ANDROID_AUTO_SUPPORT"
CONFIG_TARGET_IMX8QM_MEK=y
CONFIG_EFI_PARTITION=y
CONFIG_CMD_IMPORTENV=n
CONFIG_SYS_MALLOC_F_LEN=0x2000
CONFIG_DM=y
CONFIG_DM_WARN=n
CONFIG_DM_DEVICE_REMOVE=n

CONFIG_DM_SERIAL=n
CONFIG_FSL_LPUART=n
CONFIG_OF_CONTROL=y
CONFIG_DM_I2C=n
# CONFIG_DM_I2C_COMPAT is not set
CONFIG_SYS_I2C_IMX_LPI2C=n
CONFIG_CMD_I2C=n

CONFIG_USB=y
CONFIG_CMD_USB=y
CONFIG_DM_USB=n
CONFIG_USB_XHCI_HCD=n
CONFIG_USB_EHCI_HCD=y
CONFIG_USB_XHCI_IMX8=n
CONFIG_USB_TCPC=n
CONFIG_USB_CDNS3=n
CONFIG_USB_CDNS3_GADGET=n
CONFIG_USB_GADGET_DUALSPEED=y

CONFIG_USB_GADGET=y
CONFIG_CI_UDC=y
CONFIG_USB_GADGET_DOWNLOAD=y
CONFIG_G_DNL_MANUFACTURER="FSL"
CONFIG_G_DNL_VENDOR_NUM=0x18d1
CONFIG_G_DNL_PRODUCT_NUM=0x0d02

CONFIG_DM_GPIO=n
CONFIG_DM_PCA953X=n
CONFIG_BOOTDELAY=1
CONFIG_CMD_MMC=y
CONFIG_DM_MMC=y
# CONFIG_BLK is not set
# CONFIG_DM_MMC_OPS is not set
CONFIG_FSL_FSPI=n
CONFIG_DM_SPI=n
CONFIG_DM_SPI_FLASH=n
CONFIG_SPI_FLASH=n
CONFIG_SPI_FLASH_4BYTES_ADDR=n
CONFIG_SPI_FLASH_STMICRO=n

CONFIG_DM_REGULATOR=y
CONFIG_DM_REGULATOR_FIXED=n
CONFIG_DM_REGULATOR_GPIO=n

CONFIG_PINCTRL=y
CONFIG_PINCTRL_IMX8=y

CONFIG_CMD_NET=n
CONFIG_CMD_NFS=n
CONFIG_CMD_BDI=n
CONFIG_CMD_CONSOLE=n
CONFIG_CMD_BOOTD=n
CONFIG_CMD_BOOTEFI=n
CONFIG_CMD_BOOTEFI_HELLO_COMPILE=n
CONFIG_CMD_ELF=n
CONFIG_CMD_GO=n
CONFIG_CMD_RUN=n
CONFIG_CMD_IMI=n
CONFIG_CMD_IMLS=n
CONFIG_CMD_XIMG=n
CONFIG_CMD_EXPORTENV=n
CONFIG_CMD_IMPORTENV=n
CONFIG_CMD_EDITENV=n
CONFIG_CMD_ENV_EXISTS=n
CONFIG_CMD_MEMORY=n
CONFIG_CMD_CRC32=n
CONFIG_CMD_DM=n
CONFIG_CMD_LOADB=n
CONFIG_CMD_LOADS=n
CONFIG_CMD_FLASH=n
CONFIG_CMD_GPT=n
CONFIG_CMD_FPGA=n
CONFIG_CMD_ECHO=n
CONFIG_CMD_ITEST=n
CONFIG_CMD_SOURCE=n
CONFIG_CMD_SETEXPR=n
CONFIG_CMD_MISC=n

CONFIG_DISPLAY_CPUINFO=n
CONFIG_DISPLAY_BOARDINFO=n
CONFIG_EFI_LOADER=n

CONFIG_POWER_DOMAIN=y
CONFIG_IMX8_POWER_DOMAIN=y

CONFIG_DM_THERMAL=n
CONFIG_IMX_SC_THERMAL=n

CONFIG_LZ4=y
CONFIG_XEN=y
CONFIG_ENABLE_ARM_SOC_BOOT0_HOOK=y
CONFIG_XEN_DEBUG_SERIAL=y

CONFIG_SMC_FUSE=y
CONFIG_CMD_MEMTEST=y
```
