## drivers/crypto/fsl/Kconfig
```kconfig
config FSL_CAAM
	bool "Freescale Crypto Driver Support"
	select SHA_HW_ACCEL
	# hw_sha1() under drivers/crypto, and needed with SHA_HW_ACCEL
	select MISC if DM
	imply SPL_CRYPTO if (ARM && SPL)
	imply CMD_HASH
	help
	  Enables the Freescale's Cryptographic Accelerator and Assurance
	  Module (CAAM), also known as the SEC version 4 (SEC4). The driver uses
	  Job Ring as interface to communicate with CAAM.

config SYS_FSL_MAX_NUM_OF_SEC
	int "Number of job rings in the CAAM"
	depends on FSL_CAAM
	default 1

config CAAM_64BIT
	bool
	default y if PHYS_64BIT && !ARCH_IMX8M && !ARCH_IMX8 && !ARCH_IMX8ULP
	help
	  Select Crypto driver for 64 bits CAAM version

config SYS_FSL_HAS_SEC
	bool
	help
		Enable Freescale Secure Boot and Trusted Architecture

config SYS_FSL_SEC_COMPAT_2
	bool
	help
		Secure boot and trust architecture compatible version 2

config SYS_FSL_SEC_COMPAT_4
	bool
	help
		Secure boot and trust architecture compatible version 4

config SYS_FSL_SEC_COMPAT_5
	bool
	help
		Secure boot and trust architecture compatible version 5

config SYS_FSL_SEC_COMPAT_6
	bool
	help
		Secure boot and trust architecture compatible version 6

config SYS_FSL_SEC_BE
	bool "Big-endian access to Freescale Secure Boot"

config SYS_FSL_SEC_COMPAT
	int "Freescale Secure Boot compatibility"
	depends on SYS_FSL_HAS_SEC
	default 2 if SYS_FSL_SEC_COMPAT_2
	default 4 if SYS_FSL_SEC_COMPAT_4
	default 5 if SYS_FSL_SEC_COMPAT_5
	default 6 if SYS_FSL_SEC_COMPAT_6

config SYS_FSL_SEC_LE
	bool "Little-endian access to Freescale Secure Boot"

if FSL_CAAM

config FSL_CAAM_RNG
	bool "Enable Random Number Generator support"
	depends on DM_RNG
	default y
	help
	  Enable support for the hardware based random number generator
	  module of the CAAM. The random data is fetched from the DRGB
	  using the prediction resistance flag which means the DRGB is
	  reseeded from the TRNG every time random data is generated.

config FSL_BLOB
	bool "Enable Blob Encap/Decap, Blob KEK support"

config RNG_SELF_TEST
	bool "RNG self test"
	help
	 Enable RNG self test.
	 Following is the typical warning message when ROM/HAB fails rng self test
	 ------------+----+------+----+----------------------------------------
	 Persistent  | T  |  L   | P  | Contents
	 Memory      | a  |  e   | a  |
	 Record      | g  |  n   | r  |
	 Type        |    |  g   |    |
	             |    |  t   |    |
	             |    |  h   |    |
	 ------------+----+------+----+-------------------------------------------------
	 Event       |0xdb|0x0024|0x42| SRCE Field: 69 30 e1 1d
	             |    |      |    |             STS = HAB_WARNING (0x69)
	             |    |      |    |             RSN = HAB_ENG_FAIL (0x30)
	             |    |      |    |             CTX = HAB_CTX_ENTRY (0xE1)
	             |    |      |    |             ENG = HAB_ENG_CAAM (0x1d)
	             |    |      |    | Evt Data (hex):
	             |    |      |    |  00 04 00 02 40 00 36 06 55 55 00 03 00 00 00 00
	             |    |      |    |  00 00 00 00 00 00 00 00 00 00 00 01
	 ------------+----+------+----+-------------------------------------------------
	 In this scenario RNG self test needs to be run explicitly and
	 must be run before running any RNG based crypto implementation.

endif

config FSL_DCP_RNG
	bool "Enable Random Number Generator support"
	depends on DM_RNG
	default n
	help
	  Enable support for the hardware based random number generator
	  module of the DCP. It uses the True Random Number Generator (TRNG)
	  and a Pseudo-Random Number Generator (PRNG) to achieve a true
	  randomness and cryptographic strength.
```

## drivers/ddr/imx/phy/Kconfig
```kconfig
config IMX_SNPS_DDR_PHY
	bool "i.MX Snopsys DDR PHY"
	help
	  Select the DDR PHY driver support on i.MX8M and i.MX9 SOC.

config IMX_SNPS_DDR_PHY_QB_GEN
	bool "i.MX Synopsys DDR PHY training data generation for QuickBoot mode"
	depends on IMX_SNPS_DDR_PHY || IMX95
	help
	  Select the DDR PHY training data generation for QuickBoot support on i.MX9 SOC.

config IMX_SNPS_DDR_PHY_QB
	bool "i.MX Synopsys DDR PHY QuickBoot mode"
	depends on IMX_SNPS_DDR_PHY && !IMX_SNPS_DDR_PHY_QB_GEN
	help
	  Select the DDR PHY QuickBoot mode on i.MX9 SOC.
```

## drivers/firmware/scmi/vendors/imx/Kconfig
```kconfig
config IMX_SM_CPU
	bool "Enable i.MX System Manager CPU API"
	depends on MISC && ARCH_IMX9 && SCMI_FIRMWARE
	help
	  If you say Y here to enable i.MX System Manager CPU
	  API to work on some NXP i.MX processors.

config IMX_SM_LMM
	bool "Enable i.MX System Manager Logical Machine API"
	depends on MISC && ARCH_IMX9 && SCMI_FIRMWARE
	help
	  If you say Y here to enable i.MX System Manager Logical Machine
	  API to work on some NXP i.MX processors.
```

## drivers/video/imx/Kconfig
```kconfig
config VIDEO_IPUV3
	bool "i.MX IPUv3 Core video support"
	depends on VIDEO && (MX5 || MX6)
	help
	  This enables framebuffer driver for i.MX processors working
	  on the IPUv3(Image Processing Unit) internal graphic processor.

config IMX_VIDEO_SKIP
	bool "Enable calling board_video_skip function"
	depends on VIDEO_IPUV3

config IMX_HDMI
	bool "Enable HDMI support in IPUv3"
	depends on VIDEO_IPUV3

config VIDEO_IMX_HDP_LOAD
	bool "i.MX8 HDMI/DP firmware loading"
	default n
	depends on IMX8QM
	help
	  Support for HDMI/DP firmware loading for i.MX8QM processors. The
	  firmware is copied from system memory to the HDMI/DP IRAM and
	  DRAM memory.

config VIDEO_IMX8_HDMI
	bool "i.MX8 HDMI Splash screen"
	default n
	depends on VIDEO && IMX8M
	help
	  Support for HDMI i.MX8 processors.
```

## drivers/video/nxp/Kconfig
```kconfig
config VIDEO_NXP_HDP
	bool
	help
	  Enable NXP HDP Library for HDMI and HDMI/DP firmware loading

source "drivers/video/nxp/imx/Kconfig"
source "drivers/video/nxp/layerscape/Kconfig"
```

## drivers/video/nxp/imx/Kconfig
```kconfig
config VIDEO_IPUV3
	bool "i.MX IPUv3 Core video support"
	depends on VIDEO && (MX5 || MX6)
	help
	  This enables framebuffer driver for i.MX processors working
	  on the IPUv3(Image Processing Unit) internal graphic processor.

config IMX_VIDEO_SKIP
	bool "Enable calling board_video_skip function"
	depends on VIDEO_IPUV3

config IMX_HDMI
	bool "Enable HDMI support in IPUv3"
	depends on VIDEO_IPUV3

config VIDEO_IMXDPUV1
	bool "i.MX DPU V1 display support"
	default n
	depends on IMX8 && VIDEO
	select VIDEO_LINK
	help
	  Support for IMXDPU V1 display controller for i.MX8 processors.

config VIDEO_IMX6SX_LVDS
	bool "i.MX6SX LDVS bridge support"
	default n
	depends on MX6SX && VIDEO
	select DISPLAY
	select VIDEO_LINK
	select REGMAP
	select SYSCON
	help
	  Support for LDVS bridge controller on i.MX6SX processors.

config VIDEO_IMX8_LVDS
	bool "i.MX8 LDVS bridge support"
	default n
	depends on IMX8 && VIDEO
	select DISPLAY
	select VIDEO_LINK
	help
	  Support for i.MX8 LDVS bridge controller for i.MX8 processors.

config VIDEO_IMX_HDP_LOAD
	bool "i.MX8 HDMI/DP firmware loading"
	default n
	depends on IMX8QM
	select VIDEO_NXP_HDP
	help
	  Support for HDMI/DP firmware loading for i.MX8QM processors. The
	  firmware is copied from system memory to the HDMI/DP IRAM and
	  DRAM memory.

config VIDEO_IMX8M_DCSS
	bool "i.MX8M DCSS controller"
	default n
	depends on IMX8M && VIDEO
	select VIDEO_LINK
	help
	  Support for DCSS on i.MX8MQ processors.

config VIDEO_IMX8M_HDMI
	bool "i.MX8M HDMI Splash screen"
	default n
	depends on IMX8M && VIDEO
	select DISPLAY
	select VIDEO_LINK
	select VIDEO_NXP_HDP
	help
	  Support for HDMI on i.MX8MQ processors.

config VIDEO_SEC_MIPI_DSI
	bool
	select VIDEO_MIPI_DSI
	help
	  Enables the common driver code for the Samsung
	  MIPI DSI block found in SoCs from various vendors.
	  As this does not provide any functionality by itself (but
	  rather requires a SoC-specific glue driver to call it), it
	  can not be enabled from the configuration menu.

config VIDEO_NW_MIPI_DSI
	bool
	select VIDEO_MIPI_DSI
	help
	  Enables the common driver code for the Northwest
	  MIPI DSI block found in SoCs from various vendors.
	  As this does not provide any functionality by itself (but
	  rather requires a SoC-specific glue driver to call it), it
	  can not be enabled from the configuration menu.

config VIDEO_IMX_SEC_DSI
	bool "Enable IMX SEC DSI video support"
	select VIDEO_BRIDGE
	select VIDEO_SEC_MIPI_DSI
	select VIDEO_LINK
	help
	  This option enables support DSI internal bridge which can be used on
	  devices which have DSI devices connected.

config VIDEO_IMX_NW_DSI
	bool "Enable IMX Northwest DSI video support"
	select VIDEO_BRIDGE
	select VIDEO_NW_MIPI_DSI
	select VIDEO_LINK
	help
	  This option enables support DSI internal bridge which can be used on
	  devices which have DSI devices connected.

config VIDEO_IMX_DW_DSI
	bool "Enable Synopsys DW DSI video support"
	select VIDEO_BRIDGE
	select VIDEO_DW_MIPI_DSI
	select VIDEO_LINK
	help
	  This option enables support DSI internal bridge which can be used on
	  devices which have DSI devices connected.

config VIDEO_IMX_LCDIFV3
	bool "i.MX LCDIFv3 support"
	depends on VIDEO && (IMX8MP || IMX91 || IMX93)
	select VIDEO_LINK
	help
	  Support for i.MX8MP LCDIFv3 controller.

config VIDEO_IMX_DCIF
	bool "i.MX DCIF support"
	depends on VIDEO && IMX94
	select VIDEO_LINK
	help
	  Support for i.MX943 DCIF controller.

config VIDEO_IMX_DCNANO
	bool "i.MX DCNANO LCDIF support"
	depends on VIDEO && IMX8ULP
	select VIDEO_LINK
	help
	  Support for i.MX8ULP DCNANO LCD controller.

config VIDEO_IMX93_PARALLEL_DISPLAY_FORMAT
	bool "Support for i.MX93 parallel display format"
	select VIDEO_BRIDGE
	select VIDEO_LINK
	help
	  Choose this to enable the internal parallel display format
	  configuration found on i.MX93 processors.

config VIDEO_IMX95_LVDS
	bool "i.MX95 LDVS bridge support"
	default n
	depends on (IMX95 || IMX94) && VIDEO
	select DISPLAY
	select VIDEO_LINK
	help
	  Support for i.IMX95 LDVS bridge controller for i.IMX95 processors.

config VIDEO_IMX95_DW_DSI
	bool "Enable iMX95 Synopsys DW DSI video support"
	default n
	depends on IMX95 && VIDEO
	select VIDEO_BRIDGE
	select VIDEO_DW_MIPI_DSI
	select VIDEO_LINK
	select REGMAP
	select SYSCON
	select MULTIPLEXER
	select MUX_MMIO
	help
	  This option enables support i.MX95 DSI internal bridge which can be used on
	  devices which have DSI devices connected.

config VIDEO_IMX95_DPU
	bool "i.MX95 display controller support"
	default n
	depends on VIDEO && IMX95
	select VIDEO_LINK
	select REGMAP
	select SYSCON
	help
	  Support for i.MX95 Display controller.

config VIDEO_IMX95_PIXEL_LINK
	bool "Enable iMX95 displaymix pixel link support"
	default n
	depends on VIDEO && IMX95
	select VIDEO_BRIDGE
	select VIDEO_LINK
	select REGMAP
	select SYSCON
	help
	  Support for i.MX95 pixel link.

config VIDEO_IMX95_PIXEL_INTERLEAVER
	bool "Enable iMX95 displaymix pixel interleaver support"
	default n
	depends on VIDEO && IMX95
	select VIDEO_BRIDGE
	select VIDEO_LINK
	select REGMAP
	select SYSCON
	help
	  Support for i.MX95 pixel interleaver.
```
