## board/freescale/mx6sllevk/Kconfig
```kconfig
if TARGET_MX6SLLEVK

config SYS_BOARD
	default "mx6sllevk"

config SYS_VENDOR
	default "freescale"

config SYS_CONFIG_NAME
	default "mx6sllevk"

config SYS_TEXT_BASE
	default 0x87800000
endif
```

## board/freescale/mx6sx_17x17_arm2/Kconfig
```kconfig
if TARGET_MX6SX_17X17_ARM2 || TARGET_MX6SX_14X14_ARM2

config SYS_BOARD
	default "mx6sx_17x17_arm2"

config SYS_VENDOR
	default "freescale"

config SYS_CONFIG_NAME
	default "mx6sx_17x17_arm2"

config LPDDR2
	bool "Select for the board using LPDDR2 not default DDR3"

config NOR
	bool "Support for NOR flash"
	help
	  The i.MX SoC supports having a NOR flash connected to the WEIM.
	  Need to set this for NOR_BOOT.
endif
```

## board/freescale/mx6sx_17x17_val/Kconfig
```kconfig
if TARGET_MX6SX_17X17_VAL || TARGET_MX6SX_14X14_VAL

config SYS_BOARD
	default "mx6sx_17x17_val"

config SYS_VENDOR
	default "freescale"

config SYS_CONFIG_NAME
	default "mx6sx_17x17_val"

config SYS_TEXT_BASE
	default 0x87800000

config LPDDR2_BOARD
	bool "Select for the board using LPDDR2 not default DDR3"

config NOR
	bool "Support for NOR flash"
	help
	  The i.MX SoC supports having a NOR flash connected to the WEIM.
	  Need to set this for NOR_BOOT.
endif
```

## board/freescale/mx6sx_19x19_arm2/Kconfig
```kconfig
if TARGET_MX6SX_19X19_ARM2

config SYS_BOARD
	default "mx6sx_19x19_arm2"

config SYS_VENDOR
	default "freescale"

config SYS_CONFIG_NAME
	default "mx6sx_19x19_arm2"

endif
```

## board/freescale/mx6sx_19x19_val/Kconfig
```kconfig
if TARGET_MX6SX_19X19_VAL

config SYS_BOARD
	default "mx6sx_19x19_val"

config SYS_VENDOR
	default "freescale"

config SYS_CONFIG_NAME
	default "mx6sx_19x19_val"

config SYS_TEXT_BASE
	default 0x87800000

config LPDDR2_BOARD
	bool "Select for the board using LPDDR2 not default DDR3"

config NOR
	bool "Support for NOR flash"
	help
	  The i.MX SoC supports having a NOR flash connected to the WEIM.
	  Need to set this for NOR_BOOT.
endif
```

## board/freescale/mx6sxsabreauto/Kconfig
```kconfig
if TARGET_MX6SXSABREAUTO

config SYS_BOARD
	default "mx6sxsabreauto"

config SYS_VENDOR
	default "freescale"

config SYS_SOC
	default "mx6"

config SYS_CONFIG_NAME
	default "mx6sxsabreauto"

endif
```

## board/freescale/mx6sxsabresd/Kconfig
```kconfig
if TARGET_MX6SXSABRESD

config SYS_BOARD
	default "mx6sxsabresd"

config SYS_VENDOR
	default "freescale"

config SYS_CONFIG_NAME
	default "mx6sxsabresd"

config IMX_CONFIG
	default "board/freescale/mx6sxsabresd/imximage.cfg"

config MX6SXSABRESD_EMMC_REWORK
	bool "Select for the board with eMMC rework"

config SYS_AUXCORE_FASTUP
	bool "Enable to fast boot up M core"

config TEXT_BASE
	default 0x87800000
endif
```

## board/freescale/mx6sxscm/Kconfig
```kconfig
if TARGET_MX6SXSCM

config SYS_BOARD
	default "mx6sxscm"

config SYS_VENDOR
	default "freescale"

config SYS_CONFIG_NAME
	default "mx6sxscm"

config 512MB_LPDDR2
	bool "lpddr2 size of 512MB"
	help
	  Set the lpddr2 size to 512 MB.

config MX6SXSCM_EMMC
	bool "Select for eMMC support"
	help
	  For epop modules with eMMC on SCM.

endif
```

## board/freescale/mx6ul_14x14_ddr3_arm2/Kconfig
```kconfig
if TARGET_MX6UL_14X14_DDR3_ARM2

config SYS_BOARD
       default "mx6ul_14x14_ddr3_arm2"

config SYS_VENDOR
       default "freescale"

config SYS_CONFIG_NAME
       default "mx6ul_14x14_ddr3_arm2"

config MX6UL_DDR3_ARM2_EMMC_REWORK
	bool "Select this for the board with eMMC rework"

config MX6UL_DDR3_ARM2_USDHC2_REWORK
	bool "Select this for the board with 8bits USDHC2 rework"

config NOR
	bool "Support for NOR flash"
	help
	  The i.MX SoC supports having a NOR flash connected to the WEIM.
	  Need to set this for NOR_BOOT.
endif
```

## board/freescale/mx6ul_14x14_ddr3_val/Kconfig
```kconfig
if TARGET_MX6UL_14X14_DDR3_VAL

config SYS_BOARD
       default "mx6ul_14x14_ddr3_val"

config SYS_VENDOR
       default "freescale"

config SYS_CONFIG_NAME
       default "mx6ul_14x14_ddr3_val"

config MX6UL_DDR3_VAL_EMMC_REWORK
	bool "Select this for the board with eMMC rework"

config SYS_TEXT_BASE
	default 0x87800000

config MX6UL_DDR3_VAL_USDHC2_REWORK
	bool "Select this for the board with 8bits USDHC2 rework"

config NOR
	bool "Support for NOR flash"
	help
	  The i.MX SoC supports having a NOR flash connected to the WEIM.
	  Need to set this for NOR_BOOT.
endif
```

## board/freescale/mx6ul_14x14_evk/Kconfig
```kconfig
if TARGET_MX6UL_14X14_EVK || TARGET_MX6UL_9X9_EVK

config SYS_BOARD
	default "mx6ul_14x14_evk"

config SYS_VENDOR
	default "freescale"

config SYS_CONFIG_NAME
	default "mx6ul_14x14_evk"

config SYS_TEXT_BASE
	default 0x87800000
endif
```

## board/freescale/mx6ul_14x14_lpddr2_arm2/Kconfig
```kconfig
if TARGET_MX6UL_14X14_LPDDR2_ARM2

config SYS_BOARD
       default "mx6ul_14x14_lpddr2_arm2"

config SYS_VENDOR
       default "freescale"

config SYS_CONFIG_NAME
       default "mx6ul_14x14_lpddr2_arm2"

endif
```

## board/freescale/mx6ul_14x14_lpddr2_val/Kconfig
```kconfig
if TARGET_MX6UL_14X14_LPDDR2_VAL

config SYS_BOARD
       default "mx6ul_14x14_lpddr2_val"

config SYS_VENDOR
       default "freescale"

config SYS_CONFIG_NAME
       default "mx6ul_14x14_lpddr2_val"

config SYS_TEXT_BASE
	default 0x87800000

config MX6UL_LPDDR2_VAL_USDHC2_REWORK
	bool "Select this for the board with 8bits USDHC2 rework"

config NOR
	bool "Support for NOR flash"
	help
	  The i.MX SoC supports having a NOR flash connected to the WEIM.
	  Need to set this for NOR_BOOT.

endif
```

## board/freescale/mx6ul_aquila/Kconfig
```kconfig
if TARGET_MX6UL_AQUILA

config SYS_BOARD
	default "mx6ul_aquila"

config SYS_VENDOR
	default "freescale"

config SYS_SOC
	default "mx6"

config SYS_CONFIG_NAME
	default "mx6ul_aquila"

endif
```

## board/freescale/mx6ul_ddr3_arm2/Kconfig
```kconfig
if TARGET_MX6UL_DDR3_ARM2

config SYS_BOARD
       default "mx6ul_ddr3_arm2"

config SYS_VENDOR
       default "freescale"

config SYS_SOC
       default "mx6"

config SYS_CONFIG_NAME
       default "mx6ul_ddr3_arm2"

endif
```

## board/freescale/mx6ul_nxpu_iopb/Kconfig
```kconfig
if TARGET_MX6UL_NXPU_IOPB

config SYS_BOARD
	default "mx6ul_nxpu_iopb"

config SYS_VENDOR
	default "freescale"

config SYS_SOC
	default "mx6"

config SYS_CONFIG_NAME
	default "mx6ul_nxpu_iopb"

endif
```

## board/freescale/mx6ul_spriot/Kconfig
```kconfig
if TARGET_MX6UL_SPRIOT

config SYS_BOARD
	default "mx6ul_spriot"

config SYS_VENDOR
	default "freescale"

config SYS_SOC
	default "mx6"

config SYS_CONFIG_NAME
	default "mx6ul_spriot"

endif
```

## board/freescale/mx6ulevk/Kconfig
```kconfig
if TARGET_MX6ULEVK

config SYS_BOARD
	default "mx6ulevk"

config SYS_VENDOR
	default "freescale"

config SYS_SOC
	default "mx6"

config SYS_CONFIG_NAME
	default "mx6ulevk"

endif
```

## board/freescale/mx6ull_ddr3_arm2/Kconfig
```kconfig
if TARGET_MX6ULL_DDR3_ARM2

config SYS_BOARD
       default "mx6ull_ddr3_arm2"

config SYS_VENDOR
       default "freescale"

config SYS_CONFIG_NAME
       default "mx6ull_ddr3_arm2"

config MX6ULL_DDR3_ARM2_EMMC_REWORK
	bool "Select this for the board with eMMC rework"

config MX6ULL_DDR3_ARM2_TSC_REWORK
        bool "Select this for the board with screen touch rework"

config MX6ULL_DDR3_ARM2_QSPIB_REWORK
        bool "Select this for the board with flash on QSPI-B port rework"

endif
```

## board/freescale/mx6ull_ddr3_val/Kconfig
```kconfig
if TARGET_MX6ULL_DDR3_VAL

config SYS_BOARD
       default "mx6ull_ddr3_val"

config SYS_VENDOR
       default "freescale"

config SYS_CONFIG_NAME
       default "mx6ull_ddr3_val"

config MX6ULL_DDR3_VAL_EMMC_REWORK
	bool "Select this for the board with eMMC rework"

config SYS_TEXT_BASE
	default 0x87800000

config MX6ULL_DDR3_VAL_TSC_REWORK
        bool "Select this for the board with screen touch rework"

config MX6ULL_DDR3_VAL_QSPIB_REWORK
        bool "Select this for the board with flash on QSPI-B port rework"

endif
```

## board/freescale/mx6ullevk/Kconfig
```kconfig
if TARGET_MX6ULL_14X14_EVK || TARGET_MX6ULL_9X9_EVK

config SYS_BOARD
	default "mx6ullevk"

config SYS_VENDOR
	default "freescale"

config SYS_CONFIG_NAME
	default "mx6ullevk"

config SYS_TEXT_BASE
	default 0x87800000
endif
```

## board/freescale/mx7d_12x12_ddr3_arm2/Kconfig
```kconfig
if TARGET_MX7D_12X12_DDR3_ARM2

config SYS_BOARD
	default "mx7d_12x12_ddr3_arm2"

config SYS_VENDOR
	default "freescale"

config SYS_CONFIG_NAME
	default "mx7d_12x12_ddr3_arm2"

config SYS_TEXT_BASE
	default 0x87800000
endif
```

## board/freescale/mx7d_12x12_ddr3_val/Kconfig
```kconfig
if TARGET_MX7D_12X12_DDR3_VAL

config SYS_BOARD
	default "mx7d_12x12_ddr3_val"

config SYS_VENDOR
	default "freescale"

config SYS_CONFIG_NAME
	default "mx7d_12x12_ddr3_val"

config SYS_TEXT_BASE
	default 0x87800000
endif
```

## board/freescale/mx7d_12x12_lpddr3_arm2/Kconfig
```kconfig
if TARGET_MX7D_12X12_LPDDR3_ARM2

config SYS_BOARD
	default "mx7d_12x12_lpddr3_arm2"

config SYS_VENDOR
	default "freescale"

config SYS_CONFIG_NAME
	default "mx7d_12x12_lpddr3_arm2"

endif
```

## board/freescale/mx7d_19x19_ddr3_arm2/Kconfig
```kconfig
if TARGET_MX7D_19X19_DDR3_ARM2

config SYS_BOARD
	default "mx7d_19x19_ddr3_arm2"

config SYS_VENDOR
	default "freescale"

config SYS_SOC
	default "mx7"

config SYS_CONFIG_NAME
	default "mx7d_19x19_ddr3_arm2"

endif
```
