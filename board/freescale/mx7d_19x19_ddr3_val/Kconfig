## board/freescale/mx7d_19x19_ddr3_val/Kconfig
```kconfig
if TARGET_MX7D_19X19_DDR3_VAL

config SYS_BOARD
	default "mx7d_19x19_ddr3_val"

config SYS_VENDOR
	default "freescale"

config SYS_CONFIG_NAME
	default "mx7d_19x19_ddr3_val"

config SYS_TEXT_BASE
	default 0x87800000
endif
```

## board/freescale/mx7d_19x19_lpddr3_arm2/Kconfig
```kconfig
if TARGET_MX7D_19X19_LPDDR3_ARM2 || TARGET_MX7D_19X19_LPDDR2_ARM2

config SYS_BOARD
	default "mx7d_19x19_lpddr3_arm2"

config SYS_VENDOR
	default "freescale"

config SYS_CONFIG_NAME
	default "mx7d_19x19_lpddr3_arm2"

config NOR
	bool "Support for NOR flash"
	help
	  The i.MX SoC supports having a NOR flash connected to the WEIM.
	  Need to set this for NOR_BOOT.
endif
```

## board/freescale/mx7d_19x19_lpddr3_val/Kconfig
```kconfig
if TARGET_MX7D_19X19_LPDDR3_VAL || TARGET_MX7D_19X19_LPDDR2_VAL

config SYS_BOARD
	default "mx7d_19x19_lpddr3_val"

config SYS_VENDOR
	default "freescale"

config SYS_CONFIG_NAME
	default "mx7d_19x19_lpddr3_val"

config SYS_TEXT_BASE
	default 0x87800000

config NOR
	bool "Support for NOR flash"
	help
	  The i.MX SoC supports having a NOR flash connected to the WEIM.
	  Need to set this for NOR_BOOT.
endif
```

## board/freescale/mx7dsabresd/Kconfig
```kconfig
if TARGET_MX7DSABRESD

config SYS_BOARD
	default "mx7dsabresd"

config SYS_VENDOR
	default "freescale"

config SYS_CONFIG_NAME
	default "mx7dsabresd"

config SYS_TEXT_BASE
	default 0x87800000
endif
```

## board/freescale/mx7ulp_arm2/Kconfig
```kconfig
if TARGET_MX7ULP_10X10_ARM2 || TARGET_MX7ULP_14X14_ARM2

config SYS_BOARD
	default "mx7ulp_arm2"

config SYS_VENDOR
	default "freescale"

config SYS_CONFIG_NAME
	default "mx7ulp_arm2"

endif
```

## board/freescale/mx7ulp_val/Kconfig
```kconfig
if TARGET_MX7ULP_10X10_VAL || TARGET_MX7ULP_14X14_VAL

config SYS_BOARD
	default "mx7ulp_val"

config SYS_VENDOR
	default "freescale"

config SYS_CONFIG_NAME
	default "mx7ulp_val"

endif
```

## board/freescale/pico-imx6dl/Kconfig
```kconfig
if TARGET_PICO_IMX6DL

config SYS_CPU
	default "armv7"

config SYS_BOARD
	default "pico-imx6dl"

config SYS_VENDOR
	string
	default "freescale"

config SYS_SOC
	default "mx6"

config SYS_CONFIG_NAME
	default "pico-imx6dl"

endif
```

## board/freescale/s32v234evb/Kconfig
```kconfig
if TARGET_S32V234EVB

config SYS_BOARD
	string
	default "s32v234evb"

config SYS_CONFIG_NAME
	string
	default "s32v234evb29288" if S32V234EVB_29288
	default "s32v234evb28899" if S32V234EVB_28899

# S32V234EVB rev. A board with DDR3 has 4x512 MB DDR chips
# DDR0(1024MB) and DDR1(1024MB).
# S32V234EVB rev. D board with LPDDR2 has 2x256 MB DDR chips
# DDR0(256MB) and DDR1(256MB).
# U-boot uses only one DDR slot for the boards which don't have
# the DDR slots mapped as contiguous memory, otherwise uses
# both DDR slots.

config SYS_DDR_SIZE
	hex
	default 0x80000000 if S32V234_DDR3
	default 0x10000000 if S32V234_LPDDR2

config PHY_RGMII_DIRECT_CONNECTED
	bool "Enable fixed PHY for MDIO Bus/PHY emulation with fixed speed/link PHYs"
	default n
	help
	  Adds the platform "fixed" MDIO Bus to cover the boards that
	  use PHYs that are not connected to the real MDIO bus.

config S32V234_FAST_BOOT
	bool "Configure DCD and RUNMODE for a fast-boot efused board"
	default n
	help
	  Configure DCD and RUNMODE for a board that has been efused such that
	  OCOTP_CFG6:[19]FAST_BOOT_ENABLE = 0 and OCOTP_CFG6:[18]NO_PLL = 1.
endif
```

## board/freescale/s32v234pcie/Kconfig
```kconfig
if TARGET_S32V234PCIE

config SYS_BOARD
	string
	default "s32v234pcie"

config SYS_CONFIG_NAME
	string
	default "s32v234pcie"

# S32V234PCIE board with LPDDR2 has 2x256 MB DDR chips
# DDR0(256MB) and DDR1(256MB).
# U-boot uses only one DDR slot.
config SYS_DDR_SIZE
	hex
	default 0x10000000 if S32V234_LPDDR2

config PHY_RGMII_DIRECT_CONNECTED
	bool "Enable fixed PHY for MDIO Bus/PHY emulation with fixed speed/link PHYs"
	default n
	help
	  Adds the platform "fixed" MDIO Bus to cover the boards that use
	  PHYs that are not connected to the real MDIO bus.

config S32V234_FAST_BOOT
	bool "Configure DCD and RUNMODE for a fast-boot efused board"
	default n
	help
	  Configure DCD and RUNMODE for a board that has been efused such that
	  OCOTP_CFG6:[19]FAST_BOOT_ENABLE = 0 and OCOTP_CFG6:[18]NO_PLL = 1.

endif
```

## board/microsys/mpxs32v234/Kconfig
```kconfig
# (C) Copyright 2017 MicroSys Electronics GmbH

if TARGET_MPXS32V234

config SYS_BOARD
	string
	default "mpxs32v234"

config SYS_VENDOR
	string
	default "microsys"

config SYS_CONFIG_NAME
	string
	default "s32v234sbc"

# S32V234EVB rev. A board with DDR3 has 4x512 MB DDR chips
# DDR0(512MB) and DDR1(512MB).
# S32V234EVB rev. D board with LPDDR2 has 2x256 MB DDR chips
# DDR0(256MB) and DDR1(256MB).
# U-boot uses only one DDR slot.

config SYS_DDR_SIZE
	hex
	default 0x80000000 if S32V234_DDR3
	default 0x10000000 if S32V234_LPDDR2

endif
```

## board/technexion/pico-imx6dl/Kconfig
```kconfig
if TARGET_PICO_IMX6DL

config SYS_BOARD
	default "pico-imx6dl"

config SYS_VENDOR
	default "technexion"

config SYS_SOC
	default "mx6"

config SYS_CONFIG_NAME
	default "pico-imx6dl"

endif
```

## board/technexion/picosom-imx6ul/Kconfig
```kconfig
if TARGET_PICOSOM_IMX6UL

config SYS_BOARD
	default "picosom-imx6ul"

config SYS_VENDOR
	default "technexion"

config SYS_CONFIG_NAME
	default "picosom-imx6ul"

endif
```

## board/toradex/titan-imx95/Kconfig
```kconfig
if TARGET_TITAN_IMX95_19X19

config SYS_BOARD
	default "titan-imx95"

config SYS_VENDOR
	default "toradex"

config SYS_CONFIG_NAME
	default "titan-imx95"

endif
```

## cmd/fastboot/Kconfig
```kconfig
comment "FASTBOOT"

config NOT_UUU_BUILD
	bool "Disable features used by uuu"
	help
	  This disables the features used by uuu, so that users can't
	  execute u-boot command other than fastboot throuth the fastboot
	  function provided by uuu.

menuconfig FASTBOOT
	bool "Fastboot support"
	depends on USB_GADGET
	default y if ARCH_SUNXI && USB_MUSB_GADGET

if FASTBOOT

config USB_FUNCTION_FASTBOOT
	bool "Enable USB fastboot gadget"
	default y
	select USB_GADGET_DOWNLOAD
	imply ANDROID_BOOT_IMAGE
	imply CMD_FASTBOOT
	help
	  This enables the USB part of the fastboot gadget.

config CMD_FASTBOOT
	bool "Enable FASTBOOT command"
	help
	  This enables the command "fastboot" which enables the Android
	  fastboot mode for the platform's USB device. Fastboot is a USB
	  protocol for downloading images, flashing and device control
	  used on Android devices.

	  See doc/README.android-fastboot for more information.

config FSL_FASTBOOT
	bool "Enable FSL fastboot support"
	help
	  This enables FSL implementation for Android fastboot.

if FSL_FASTBOOT

config ANDROID_RECOVERY
	bool "Enable the recovery boot function"
	help
	  This enables the Android Recovery boot function.

config CMD_BOOTA
	bool "Enable the boota command"
	help
	  This enables the boota command for booting android images.

config BCB_SUPPORT
	bool "Enable the boot control block support"
	help
	  This enables the boot control block support for android reboot command

choice
        prompt "Android Image Storage select"
        default FASTBOOT_STORAGE_MMC

config FASTBOOT_STORAGE_MMC
	bool "Using eMMC/SD for Android fastboot storage media"

config FASTBOOT_STORAGE_NAND
	bool "Using NAND flash for Android fastboot storage media"

config FASTBOOT_STORAGE_SATA
	bool "Using SATA disk for Android fastboot storage media"

endchoice

config FASTBOOT_SATA_NO
	int "Sata device index"
	depends on FASTBOOT_STORAGE_SATA

endif #FSL_FASTBOOT

if USB_FUNCTION_FASTBOOT

config FASTBOOT_BUF_ADDR
	hex "Define FASTBOOT buffer address"
	default 0x82000000 if MX6SX || MX6SL || MX6UL || MX6SLL
	default 0x81000000 if ARCH_OMAP2PLUS
	default 0x42000000 if ARCH_SUNXI && !MACH_SUN9I
	default 0x22000000 if ARCH_SUNXI && MACH_SUN9I
	default 0x60800800 if ROCKCHIP_RK3036 || ROCKCHIP_RK3188 || \
				ROCKCHIP_RK322X
	default 0x800800 if ROCKCHIP_RK3288 || ROCKCHIP_RK3329 || \
				ROCKCHIP_RK3399
	default 0x280000 if ROCKCHIP_RK3368
	default 0x100000 if ARCH_ZYNQMP
	help
	  The fastboot protocol requires a large memory buffer for
	  downloads. Define this to the starting RAM address to use for
	  downloaded images.

config FASTBOOT_BUF_SIZE
	hex "Define FASTBOOT buffer size"
	default 0x8000000 if ARCH_ROCKCHIP
	default 0x6000000 if ARCH_ZYNQMP
	default 0x2000000 if ARCH_SUNXI
	default 0x7000000
	help
	  The fastboot protocol requires a large memory buffer for
	  downloads. This buffer should be as large as possible for a
	  platform. Define this to the size available RAM for fastboot.

config FASTBOOT_USB_DEV
	int "USB controller number"
	default 0
	help
	  Some boards have USB OTG controller other than 0. Define this
	  option so it can be used in compiled environment (e.g. in
	  CONFIG_BOOTCOMMAND).

config FASTBOOT_FLASH
	bool "Enable FASTBOOT FLASH command"
	default y if ARCH_SUNXI
	help
	  The fastboot protocol includes a "flash" command for writing
	  the downloaded image to a non-volatile storage device. Define
	  this to enable the "fastboot flash" command.

choice
	prompt "Flash provider for FASTBOOT"
	depends on FASTBOOT_FLASH

config FASTBOOT_FLASH_MMC
	bool "FASTBOOT on MMC"
	depends on MMC

config FASTBOOT_FLASH_NAND
	bool "FASTBOOT on NAND"
	depends on NAND

endchoice

config FASTBOOT_FLASH_MMC_DEV
	int "Define FASTBOOT MMC FLASH default device"
	depends on FASTBOOT_FLASH_MMC
	default 0 if ARCH_SUNXI && MMC_SUNXI_SLOT_EXTRA = -1
	default 1 if ARCH_SUNXI && MMC_SUNXI_SLOT_EXTRA != -1
	help
	  The fastboot "flash" command requires additional information
	  regarding the non-volatile storage device. Define this to
	  the eMMC device that fastboot should use to store the image.

config FASTBOOT_FLASH_NAND_DEV
	int "Define FASTBOOT NAND FLASH default device"
	depends on FASTBOOT_FLASH_NAND
	depends on CMD_MTDPARTS
	default 0 if ARCH_SUNXI && NAND_SUNXI
	help
	  The fastboot "flash" command requires additional information
	  regarding the non-volatile storage device. Define this to
	  the NAND device that fastboot should use to store the image.

config FASTBOOT_GPT_NAME
	string "Target name for updating GPT"
	depends on FASTBOOT_FLASH
	default "gpt"
	help
	  The fastboot "flash" command supports writing the downloaded
	  image to the Protective MBR and the Primary GUID Partition
	  Table. (Additionally, this downloaded image is post-processed
	  to generate and write the Backup GUID Partition Table.)
	  This occurs when the specified "partition name" on the
	  "fastboot flash" command line matches the value defined here.
	  The default target name for updating GPT is "gpt".

config FASTBOOT_MBR_NAME
	string "Target name for updating MBR"
	depends on FASTBOOT_FLASH
	default "mbr"
	help
	  The fastboot "flash" command allows to write the downloaded image
	  to the Master Boot Record. This occurs when the "partition name"
	  specified on the "fastboot flash" command line matches the value
	  defined here. The default target name for updating MBR is "mbr".

endif # USB_FUNCTION_FASTBOOT

endif # FASTBOOT
```

## configs/imx6sxsabreautoandroid_defconfig
```kconfig
CONFIG_ARM=y
CONFIG_ARCH_MX6=y
CONFIG_TARGET_MX6SXSABREAUTO=y
CONFIG_DEFAULT_DEVICE_TREE="imx6sx-sabreauto"
CONFIG_SYS_EXTRA_OPTIONS="IMX_CONFIG=board/freescale/mx6sxsabreauto/imximage.cfg,ANDROID_SUPPORT"
CONFIG_EFI_PARTITION=y
CONFIG_BOOTDELAY=0
CONFIG_HUSH_PARSER=y
CONFIG_CMD_BOOTZ=y
# CONFIG_CMD_IMLS is not set
# CONFIG_CMD_FLASH is not set
CONFIG_CMD_MEMTEST=y
CONFIG_CMD_GPIO=y
CONFIG_CMD_I2C=y
CONFIG_CMD_MMC=y
CONFIG_CMD_NAND=y
CONFIG_CMD_NAND_TRIMFFS=y
CONFIG_CMD_SF=y
CONFIG_CMD_USB=y
# CONFIG_CMD_SETEXPR is not set
CONFIG_CMD_DHCP=y
CONFIG_CMD_MII=y
CONFIG_CMD_PING=y
CONFIG_CMD_CACHE=y
CONFIG_CMD_TIME=y
CONFIG_CMD_REGULATOR=y
CONFIG_CMD_EXT2=y
CONFIG_CMD_EXT4=y
CONFIG_CMD_EXT4_WRITE=y
CONFIG_CMD_FAT=y
CONFIG_CMD_FS_GENERIC=y
CONFIG_OF_CONTROL=y
CONFIG_DM_GPIO=y
CONFIG_DM_PCA953X=y
CONFIG_DM_I2C=y
CONFIG_DM_MMC=y
CONFIG_NAND=y
CONFIG_NAND_MXS=y
CONFIG_SPI=y
CONFIG_DM_SPI=y
CONFIG_DM_SPI_FLASH=y
CONFIG_SF_DEFAULT_MODE=0
CONFIG_SF_DEFAULT_SPEED=40000000
CONFIG_SPI_FLASH=y
CONFIG_SPI_FLASH_BAR=y
CONFIG_SPI_FLASH_STMICRO=y
CONFIG_PHYLIB=y
CONFIG_MII=y
CONFIG_PINCTRL=y
CONFIG_PINCTRL_IMX6=y
CONFIG_DM_PMIC=y
CONFIG_DM_PMIC_PFUZE100=y
CONFIG_DM_REGULATOR=y
CONFIG_DM_REGULATOR_PFUZE100=y
CONFIG_DM_REGULATOR_FIXED=y
CONFIG_DM_REGULATOR_GPIO=y
CONFIG_DM_ETH=y
CONFIG_FSL_QSPI=y
CONFIG_USB=y
CONFIG_DM_USB=y
CONFIG_USB_STORAGE=y
CONFIG_USB_HOST_ETHER=y
CONFIG_USB_ETHER_ASIX=y

CONFIG_IMX_BOOTAUX=y

CONFIG_USB_GADGET=y
CONFIG_USB_GADGET_DOWNLOAD=y
CONFIG_USB_GADGET_MANUFACTURER="FSL"
CONFIG_USB_GADGET_VENDOR_NUM=0x0525
CONFIG_USB_GADGET_PRODUCT_NUM=0xa4a5
CONFIG_CI_UDC=y

CONFIG_CMD_FASTBOOT=y
CONFIG_USB_FUNCTION_FASTBOOT=y
CONFIG_FASTBOOT_UUU_SUPPORT=n
CONFIG_FSL_FASTBOOT=y
CONFIG_FASTBOOT=y
CONFIG_FASTBOOT_BUF_ADDR=0x83800000
CONFIG_FASTBOOT_BUF_SIZE=0x19000000
CONFIG_FASTBOOT_FLASH=y
CONFIG_LIBAVB=y
```

## configs/imx7dsabresdbrillo_defconfig
```kconfig
CONFIG_ARM=y
CONFIG_ARCH_MX7=y
CONFIG_TARGET_MX7DSABRESD=y
CONFIG_ARMV7_BOOT_SEC_DEFAULT=y
# CONFIG_ARMV7_VIRT is not set
CONFIG_IMX_RDC=y
CONFIG_IMX_BOOTAUX=y
CONFIG_DEFAULT_DEVICE_TREE="imx7d-sdb"
CONFIG_SYS_EXTRA_OPTIONS="IMX_CONFIG=board/freescale/mx7dsabresd/imximage.cfg,ANDROID_THINGS_SUPPORT"
CONFIG_EFI_PARTITION=y
CONFIG_BOOTDELAY=0
# CONFIG_CONSOLE_MUX is not set
CONFIG_SYS_CONSOLE_IS_IN_ENV=y
CONFIG_HUSH_PARSER=y
CONFIG_CMD_BOOTZ=y
# CONFIG_CMD_IMI is not set
# CONFIG_CMD_IMLS is not set
# CONFIG_CMD_XIMG is not set
# CONFIG_CMD_EXPORTENV is not set
# CONFIG_CMD_IMPORTENV is not set
CONFIG_CMD_MEMTEST=y
CONFIG_CMD_GPIO=y
CONFIG_CMD_I2C=y
CONFIG_CMD_MMC=y
CONFIG_CMD_SF=y
CONFIG_CMD_USB=y
CONFIG_CMD_DHCP=y
CONFIG_CMD_MII=y
CONFIG_CMD_PING=y
CONFIG_CMD_BMP=y
CONFIG_CMD_CACHE=y
CONFIG_CMD_PMIC=y
CONFIG_CMD_REGULATOR=y
CONFIG_CMD_EXT2=y
CONFIG_CMD_EXT4=y
CONFIG_CMD_EXT4_WRITE=y
CONFIG_CMD_FAT=y
CONFIG_OF_CONTROL=y
CONFIG_DM_GPIO=y
CONFIG_DM_74X164=y
CONFIG_DM_I2C=y
CONFIG_DM_MMC=y
CONFIG_MMC_IO_VOLTAGE=y
CONFIG_MMC_UHS_SUPPORT=y
CONFIG_MMC_HS200_SUPPORT=y
CONFIG_SPI=y
CONFIG_SPI_FLASH=y
CONFIG_SPI_FLASH_EON=y
CONFIG_PHYLIB=y
CONFIG_MII=y
CONFIG_PINCTRL=y
CONFIG_PINCTRL_IMX7=y
CONFIG_DM_PMIC=y
CONFIG_DM_PMIC_PFUZE100=y
CONFIG_DM_REGULATOR=y
CONFIG_DM_REGULATOR_PFUZE100=y
CONFIG_DM_REGULATOR_FIXED=y
CONFIG_DM_REGULATOR_GPIO=y
CONFIG_DM_SPI=y
CONFIG_SOFT_SPI=y
CONFIG_USB=y
CONFIG_DM_USB=y
CONFIG_USB_EHCI_HCD=y
CONFIG_MXC_USB_OTG_HACTIVE=y
CONFIG_USB_STORAGE=y
CONFIG_USB_HOST_ETHER=y
CONFIG_USB_ETHER_ASIX=y
CONFIG_VIDEO=y
CONFIG_ERRNO_STR=y
CONFIG_DM_ETH=y

CONFIG_USB_GADGET=y
CONFIG_USB_GADGET_MANUFACTURER="FSL"
CONFIG_USB_GADGET_VENDOR_NUM=0x0525
CONFIG_USB_GADGET_PRODUCT_NUM=0xa4a5
CONFIG_CI_UDC=y
CONFIG_USB_GADGET_DOWNLOAD=y

CONFIG_CMD_FASTBOOT=y
CONFIG_USB_FUNCTION_FASTBOOT=y
CONFIG_FASTBOOT_UUU_SUPPORT=n
CONFIG_FASTBOOT=y
CONFIG_FASTBOOT_BUF_ADDR=0x83800000
CONFIG_FASTBOOT_BUF_SIZE=0x19000000
CONFIG_FASTBOOT_FLASH=y
CONFIG_FSL_FASTBOOT=y
CONFIG_EFI_PARTITION=y

CONFIG_LIBAVB=y
```
