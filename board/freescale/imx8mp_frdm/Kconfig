## board/freescale/imx8mp_frdm/Kconfig
```kconfig
if TARGET_IMX8MP_FRDM

config SYS_BOARD
	default "imx8mp_frdm"

config SYS_VENDOR
	default "freescale"

config SYS_CONFIG_NAME
	default "imx8mp_frdm"

config IMX_CONFIG
	default "board/freescale/imx8mp_frdm/imximage-8mp-lpddr4.cfg"

endif
```

## board/freescale/imx8mq_aiy/Kconfig
```kconfig
if TARGET_IMX8MQ_AIY

config SYS_BOARD
	default "imx8mq_aiy"

config SYS_VENDOR
	default "freescale"

config SYS_CONFIG_NAME
	default "imx8mq_aiy"

source "board/freescale/common/Kconfig"

endif
```

## board/freescale/imx8mq_arm2/Kconfig
```kconfig
if TARGET_IMX8MQ_DDR3L_ARM2 || TARGET_IMX8MQ_DDR4_ARM2

config SYS_BOARD
	default "imx8mq_arm2"

config SYS_VENDOR
	default "freescale"

config SYS_CONFIG_NAME
	default "imx8mq_arm2"

endif
```

## board/freescale/imx8mq_evk/Kconfig
```kconfig
if TARGET_IMX8MQ_EVK

config SYS_BOARD
	default "imx8mq_evk"

config SYS_VENDOR
	default "freescale"

config SYS_CONFIG_NAME
	default "imx8mq_evk"

config IMX_CONFIG
	default "arch/arm/mach-imx/imx8m/imximage.cfg"

config IMX8MQ_4GB_DDR_TIMING
	bool "Use DDR timing file for 4GB WEVK"
	help
	  Select to use DDR timing file for WEVK board
	  which has 4GB LPDDR4.

endif
```

## board/freescale/imx8mq_val/Kconfig
```kconfig
if TARGET_IMX8MQ_DDR3L_VAL || TARGET_IMX8MQ_DDR4_VAL

config SYS_BOARD
	default "imx8mq_val"

config SYS_VENDOR
	default "freescale"

config SYS_CONFIG_NAME
	default "imx8mq_val"

endif
```

## board/freescale/imx8qm_arm2/Kconfig
```kconfig
if TARGET_IMX8QM_LPDDR4_ARM2 || TARGET_IMX8QM_DDR4_ARM2

config SYS_BOARD
	default "imx8qm_arm2"

config SYS_VENDOR
	default "freescale"

config SYS_CONFIG_NAME
	default "imx8qm_arm2"

endif
```

## board/freescale/imx8qm_mek/Kconfig
```kconfig
if TARGET_IMX8QM_MEK || TARGET_IMX8QM_MEK_A53_ONLY || TARGET_IMX8QM_MEK_A72_ONLY

config SYS_BOARD
	default "imx8qm_mek"

config SYS_VENDOR
	default "freescale"

config SYS_CONFIG_NAME
	default "imx8qm_mek"

config IMX_CONFIG
	default "board/freescale/imx8qm_mek/imximage.cfg"

source "board/freescale/common/Kconfig"

endif
```

## board/freescale/imx8qm_val/Kconfig
```kconfig
if TARGET_IMX8QM_LPDDR4_VAL || TARGET_IMX8QM_DDR4_VAL

config SYS_BOARD
	default "imx8qm_val"

config SYS_VENDOR
	default "freescale"

config SYS_CONFIG_NAME
	default "imx8qm_val"

config IMX_CONFIG
	default "board/freescale/imx8qm_val/imximage.cfg"

endif
```

## board/freescale/imx8qxp_arm2/Kconfig
```kconfig
if TARGET_IMX8QXP_LPDDR4_ARM2 || TARGET_IMX8QXP_DDR3_ARM2

config SYS_BOARD
	default "imx8qxp_arm2"

config SYS_VENDOR
	default "freescale"

config SYS_CONFIG_NAME
	default "imx8qxp_arm2"

endif
```

## board/freescale/imx8qxp_val/Kconfig
```kconfig
if TARGET_IMX8QXP_LPDDR4_VAL || TARGET_IMX8QXP_DDR3_VAL || TARGET_IMX8X_17X17_VAL

config SYS_BOARD
	default "imx8qxp_val"

config SYS_VENDOR
	default "freescale"

config SYS_CONFIG_NAME
	default "imx8qxp_val"

endif
```

## board/freescale/imx8ulp_evk/Kconfig
```kconfig
if TARGET_IMX8ULP_EVK || TARGET_IMX8ULP_9X9_EVK

config SYS_BOARD
	default "imx8ulp_evk"

config SYS_VENDOR
	default "freescale"

config SYS_CONFIG_NAME
	default "imx8ulp_evk"

source "board/freescale/common/Kconfig"

endif
```

## board/freescale/imx8ulp_watch/Kconfig
```kconfig
if TARGET_IMX8ULP_WATCH

config SYS_BOARD
	default "imx8ulp_watch"

config SYS_VENDOR
	default "freescale"

config SYS_CONFIG_NAME
	default "imx8ulp_watch"

source "board/freescale/common/Kconfig"

endif
```

## board/freescale/imx91_frdm/Kconfig
```kconfig
if TARGET_IMX91_11X11_FRDM

config SYS_BOARD
	default "imx91_frdm"

config SYS_VENDOR
	default "freescale"

config SYS_CONFIG_NAME
	default "imx91_frdm"

config IMX91_FRDM_LPDDR4
	bool "Using LPDDR4 Timing and PMIC voltage"
	default y
	select IMX9_LPDDR4X
	help
	  Select the LPDDR4 timing and 1.1V VDDQ

endif
```

## board/freescale/imx91_frdm_imx91s/Kconfig
```kconfig
if TARGET_IMX91_11X11_FRDM_IMX91S

config SYS_BOARD
	default "imx91_frdm_imx91s"

config SYS_VENDOR
	default "freescale"

config SYS_CONFIG_NAME
	default "imx91_frdm_imx91s"

config IMX91_FRDM_IMX91S_LPDDR4
	bool "Using LPDDR4 Timing and PMIC voltage"
	default y
	select IMX9_LPDDR4X
	help
	  Select the LPDDR4 timing and 1.1V VDDQ

endif
```

## board/freescale/imx93_evk/Kconfig
```kconfig
if TARGET_IMX93_11X11_EVK || TARGET_IMX93_14X14_EVK || TARGET_IMX91P_11X11_EVK

config SYS_BOARD
	default "imx93_evk"

config SYS_VENDOR
	default "freescale"

config SYS_CONFIG_NAME
	default "imx93_evk"

choice
	prompt "Select DDR Type"
	default IMX93_EVK_LPDDR4X if TARGET_IMX93_11X11_EVK || TARGET_IMX93_14X14_EVK
	default IMX93_EVK_LPDDR4 if TARGET_IMX91P_11X11_EVK

config IMX93_EVK_LPDDR4X
	bool "Using LPDDR4X Timing and PMIC voltage"
	select IMX9_LPDDR4X
	help
	  Select the LPDDR4X timing and 0.6V VDDQ

config IMX93_EVK_LPDDR4
	bool "Using LPDDR4 Timing and PMIC voltage"
	select IMX9_LPDDR4X
	help
	  Select the LPDDR4 timing and 1.1V VDDQ

endchoice

endif
```

## board/freescale/imx94_orangebox/Kconfig
```kconfig
if TARGET_IMX943_ORANGEBOX

config SYS_BOARD
	default "imx94_orangebox"

config SYS_VENDOR
	default "freescale"

config SYS_CONFIG_NAME
	default "imx94_orangebox"

endif
```

## board/freescale/multa-imx7d/Kconfig
```kconfig
if TARGET_MULTA_IMX7D

config SYS_BOARD
	default "multa-imx7d"

config SYS_VENDOR
	default "freescale"

config SYS_CONFIG_NAME
	default "multa-imx7d"

endif
```

## board/freescale/mx6dqscm/Kconfig
```kconfig
if TARGET_MX6DQSCM

config SYS_BOARD
	default "mx6dqscm"

config SYS_VENDOR
	default "freescale"

config SYS_CONFIG_NAME
	default "mx6dqscm"

config QWKS_REV3
	bool "Support for SCM QWKS rev3 board"
	help
	  Enable this when building for SCM QWKS board rev3 (revC).

config SCMEVB
	bool "Support for SCM EVB board"
	help
	  Enable this when building for SCM EVB board.

config SCMHVB
	bool "Support for Hardware Evaluation board"
	help
	  Enable this when building for SCM HVB board.

config INTERLEAVING_MODE
	bool "Interleaving mode"
	help
	  Enable the MMDC interlaving mode for lpddr2
	  fix mode is used when this is not enabled.

config SCM_LPDDR2_512MB
	bool "lpddr2 size of 512MB"
	help
	  Set the lpddr2 size to 512 MB
	  1GB is defaulted size.


config SCM_LPDDR2_2GB
	bool "lpddr2 size of 2GB"
	help
	  Set the lpddr2 size to 2GB
	  1GB is defaulted size.

endif
```

## board/freescale/mx6qarm2/Kconfig
```kconfig
if TARGET_MX6QARM2 || TARGET_MX6DLARM2

config SYS_BOARD
	default "mx6qarm2"

config SYS_VENDOR
	default "freescale"

config SYS_CONFIG_NAME
	default "mx6qarm2"

config SYS_TEXT_BASE
    default 0x17800000

config MX6DQ_POP_LPDDR2
	bool "Select this if it is a MX6Q POP LPDDR2 board"

endif
```

## board/freescale/mx6qsabreauto/Kconfig
```kconfig
if TARGET_MX6QSABREAUTO

config SYS_BOARD
	default "mx6qsabreauto"

config SYS_VENDOR
	default "freescale"

config SYS_CONFIG_NAME
	default "mx6qsabreauto"

config NOR
	bool "Support for NOR flash"
	help
	  The i.MX SoC supports having a NOR flash connected to the WEIM.
	  Need to set this for NOR_BOOT.
endif
```

## board/freescale/mx6sabreauto/Kconfig
```kconfig
if TARGET_MX6SABREAUTO || TARGET_MX6SABREAUTO_COMMON

config SYS_BOARD
	default "mx6sabreauto"

config SYS_VENDOR
	default "freescale"

config SYS_CONFIG_NAME
	default "mx6sabreauto"

config SYS_TEXT_BASE
    default 0x17800000

config NOR
	bool "Support for NOR flash"
	help
	  The i.MX SoC supports having a NOR flash connected to the WEIM.
	  Need to set this for NOR_BOOT.
endif
```

## board/freescale/mx6sabresd/Kconfig
```kconfig
if TARGET_MX6SABRESD || TARGET_MX6SABRESD_COMMON

config SYS_BOARD
	default "mx6sabresd"

config SYS_VENDOR
	default "freescale"

config SYS_CONFIG_NAME
	default "mx6sabresd"

config SYS_TEXT_BASE
    default 0x17800000

endif
```

## board/freescale/mx6slevk/Kconfig
```kconfig
if TARGET_MX6SLEVK

config SYS_BOARD
	default "mx6slevk"

config SYS_VENDOR
	default "freescale"

config SYS_CONFIG_NAME
	default "mx6slevk"

config SYS_TEXT_BASE
	default 0x87800000
endif
```

## board/freescale/mx6sll_arm2/Kconfig
```kconfig
if TARGET_MX6SLL_ARM2

config SYS_BOARD
	default "mx6sll_arm2"

config SYS_VENDOR
	default "freescale"

config SYS_CONFIG_NAME
	default "mx6sll_arm2"

config LPDDR2_BOARD
	bool "set if the board uses the LPDDR2 not default LPDDR3" 

config SYS_TEXT_BASE
	default 0x87800000

endif
```

## board/freescale/mx6sll_val/Kconfig
```kconfig
if TARGET_MX6SLL_VAL

config SYS_BOARD
	default "mx6sll_val"

config SYS_VENDOR
	default "freescale"

config SYS_CONFIG_NAME
	default "mx6sll_val"

config LPDDR2_BOARD
	bool "set if the board uses the LPDDR2 not default LPDDR3" 

config SYS_TEXT_BASE
	default 0x87800000

endif
```
