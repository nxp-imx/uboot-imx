## arch/arm/mach-imx/imx9/Kconfig
```kconfig
if ARCH_IMX9

config AHAB_BOOT
    bool "Support i.MX9 AHAB features"
    help
    This option enables the support for AHAB secure boot.

config SPL_IMX_BBSM
    bool "Support BBSM Tamper Detection feature"
	depends on IMX93 || IMX95
	default n
    help
      This option enables the support for BBSM Tamper Detection. This option is
      only supported on i.MX93 and i.MX95.

config IMX_CRRM
    bool "Support i.MX9 cyber resilient recovery module (CRRM)"
	depends on IMX94 || IMX952
	select PSCI_BOARD_REBOOT
    help
      This option enables the support for IMX CRRM.

config IMX_CRRM_PROTECT_SIZE
	hex "Specify the size for XSPI protected image"
	depends on IMX_CRRM
	default 0x400000

config IMX_CRRM_AWDT_TIMEOUT
	int "Specify the initialized timeout(ms) for CRRM AWDT timer"
	depends on IMX_CRRM
	default 300000

config IMX_CRRM_SELFTEST
    bool "Enable CRRM self test routing in SPL/u-boot"
    help
      This option enables CRRM self test. No CRRM OS is needed in the test.

config IMX9
	bool
	select CPU
	select CPU_IMX
	select HAS_CAAM
	select ROM_UNIFIED_SECTIONS
	imply IMX_TMU

config IMX93
	bool
	select IMX9
	select ARCH_MISC_INIT
	select ARMV8_SPL_EXCEPTION_VECTORS
	select SYS_FSL_ERRATUM_052357

config IMX937
	bool
	select IMX952

config IMX91
	bool
	select IMX9
	select ARCH_MISC_INIT
	select ARMV8_SPL_EXCEPTION_VECTORS
	select SYS_FSL_ERRATUM_052357

config IMX95_A0
	bool "Support for i.MX95 A0 silicon version"

config IMX95
	bool
	select ARCH_MISC_INIT
	select ARMV8_SPL_EXCEPTION_VECTORS
	select IMX9
	select DM_MAILBOX
	select SCMI_FIRMWARE
	select SPL_IMX_CONTAINER_USE_TRAMPOLINE
	select IMX_PQC_SUPPORT if !IMX95_A0

config IMX94
	bool
	select ARCH_MISC_INIT
	select ARMV8_SPL_EXCEPTION_VECTORS
	select DM_MAILBOX
	select IMX9
	select IMX_PQC_SUPPORT
	select SCMI_FIRMWARE
	select SPL_IMX_CONTAINER_USE_TRAMPOLINE

config IMX952
	bool
	select ARCH_MISC_INIT
	select ARMV8_SPL_EXCEPTION_VECTORS
	select IMX9
	select DM_MAILBOX
	select SCMI_FIRMWARE
	select SPL_IMX_CONTAINER_USE_TRAMPOLINE
	select IMX_PQC_SUPPORT

config SYS_SOC
	default "imx9"

choice
	prompt  "NXP i.MX9 board select"
	optional

config TARGET_IMX91_11X11_EVK
	bool "imx91_11x11_evk"
	select OF_BOARD_FIXUP
	select IMX91
	imply OF_UPSTREAM
	imply BOOTSTD_FULL
	imply BOOTSTD_BOOTCOMMAND

config TARGET_IMX91_11X11_FRDM
	bool "imx91_11x11_frdm"
	select OF_BOARD_FIXUP
	select IMX91
	select IMX9_LPDDR4X
	imply BOOTSTD_FULL
	imply BOOTSTD_BOOTCOMMAND

config TARGET_IMX93_9X9_QSB
	bool "imx93_qsb"
	select OF_BOARD_FIXUP
	select IMX93
	select IMX9_LPDDR4X
	imply OF_UPSTREAM
	imply BOOTSTD_FULL
	imply BOOTSTD_BOOTCOMMAND
	select CMD_REMOTEPROC
	select REMOTEPROC_IMX
	select REGMAP
	select SYSCON

config TARGET_IMX91_11X11_FRDM_IMX91S
	bool "imx91_11x11_frdm_imx91s"
	select OF_BOARD_FIXUP
	select IMX91
	select IMX9_LPDDR4X
	imply BOOTSTD_FULL
	imply BOOTSTD_BOOTCOMMAND

config TARGET_IMX91_9X9_QSB
	bool "imx91_9x9_qsb"
	select OF_BOARD_FIXUP
	select IMX91
	select IMX9_LPDDR4X
	imply BOOTSTD_FULL
	imply BOOTSTD_BOOTCOMMAND

config TARGET_IMX93_14X14_EVK
	bool "imx93_14x14_evk"
	select OF_BOARD_FIXUP
	select IMX93
	imply OF_UPSTREAM
	imply BOOTSTD_FULL
	imply BOOTSTD_BOOTCOMMAND

config TARGET_IMX93_11X11_EVK
	bool "imx93_11x11_evk"
	select OF_BOARD_FIXUP
	select IMX93
	imply OF_UPSTREAM
	imply BOOTSTD_FULL
	imply BOOTSTD_BOOTCOMMAND
	select CMD_REMOTEPROC
	select REMOTEPROC_IMX
	select REGMAP
	select SYSCON

config TARGET_IMX93_11X11_FRDM
	bool "imx93_11x11_frdm"
	select OF_BOARD_FIXUP
	select IMX93
	select IMX9_LPDDR4X
	imply BOOTSTD_FULL
	imply BOOTSTD_BOOTCOMMAND
	select CMD_REMOTEPROC
	select REMOTEPROC_IMX
	select REGMAP
	select SYSCON

config TARGET_IMX93_VAR_SOM
	bool "imx93_var_som"
	select IMX93
	select IMX9_LPDDR4X

config TARGET_KONTRON_MX93
	bool "Kontron OSM-S/BL i.MX93"
	select BINMAN
	select IMX93
	select IMX9_LPDDR4X
	help
	  Kontron Electronics BL i.MX93 using SoM module conformant to OSM
	  standard 1.1 size S.

config TARGET_PHYCORE_IMX93
	bool "phycore_imx93"
	select IMX93
	select IMX9_LPDDR4X
	imply OF_UPSTREAM
	select OF_BOARD_FIXUP
	select OF_BOARD_SETUP

config TARGET_IMX937_EVK
	bool "imx937_evk"
	select IMX937
	imply BOOTSTD_BOOTCOMMAND
	imply BOOTSTD_FULL
	select CMD_REMOTEPROC
	select REMOTEPROC_IMX
	select REGMAP
	select SYSCON
	select IMX_SM_LMM
	select IMX_SM_CPU

config TARGET_IMX95_19X19_EVK
	bool "imx95_19x19_evk"
	select IMX95
	imply BOOTSTD_BOOTCOMMAND
	imply BOOTSTD_FULL

config TARGET_IMX952_EVK
	bool "imx952_evk"
	select IMX952
	imply BOOTSTD_BOOTCOMMAND
	imply BOOTSTD_FULL
	select CMD_REMOTEPROC
	select REMOTEPROC_IMX
	select REGMAP
	select SYSCON
	select IMX_SM_LMM
	select IMX_SM_CPU

config TARGET_IMX95_15X15_EVK
	bool "imx95_15x15_evk"
	select IMX95
	imply BOOTSTD_BOOTCOMMAND
	imply BOOTSTD_FULL

config TARGET_IMX95_15X15_FRDM
	bool "imx95_15x15_frdm"
	select IMX95
	imply BOOTSTD_BOOTCOMMAND
	imply BOOTSTD_FULL

config TARGET_IMX95_19X19_FRDM_PRO
	bool "imx95_19x19_frdm_pro"
	select IMX95
	imply BOOTSTD_BOOTCOMMAND
	imply BOOTSTD_FULL
	select CMD_REMOTEPROC
	select REMOTEPROC_IMX
	select REGMAP
	select SYSCON
	select IMX_SM_LMM
	select IMX_SM_CPU

config TARGET_IMX952_FRDM
	bool "imx952_frdm"
	select IMX952
	imply BOOTSTD_BOOTCOMMAND
	imply BOOTSTD_FULL
	select CMD_REMOTEPROC
	select REMOTEPROC_IMX
	select REGMAP
	select SYSCON
	select IMX_SM_LMM
	select IMX_SM_CPU

config TARGET_IMX943_EVK
	bool "imx943_evk"
	select IMX94
	select CMD_REMOTEPROC
	select REMOTEPROC_IMX
	select REGMAP
	select SYSCON
	select IMX_SM_LMM
	select IMX_SM_CPU
	imply BOOTSTD_BOOTCOMMAND
	imply BOOTSTD_FULL
	imply OF_UPSTREAM

config TARGET_TORADEX_SMARC_IMX95
	bool "Support Toradex SMARC iMX95"
	select IMX95

config TARGET_VERDIN_IMX95_19X19
	bool "imx95_verdin_evk"
	select IMX95
	imply BOOTSTD_BOOTCOMMAND
	imply BOOTSTD_FULL

config TARGET_IMX943_ORANGEBOX
	bool "imx943_orangebox"
	select IMX94
	imply BOOTSTD_BOOTCOMMAND
	imply BOOTSTD_FULL

endchoice

source "board/nxp/imx91_evk/Kconfig"
source "board/nxp/imx91_frdm_imx91s/Kconfig"
source "board/nxp/imx91_qsb/Kconfig"
source "board/nxp/imx91_frdm/Kconfig"
source "board/nxp/imx93_evk/Kconfig"
source "board/nxp/imx93_frdm/Kconfig"
source "board/nxp/imx93_qsb/Kconfig"
source "board/kontron/osm-s-mx93/Kconfig"
source "board/phytec/phycore_imx93/Kconfig"
source "board/variscite/imx93_var_som/Kconfig"
source "board/nxp/imx94_evk/Kconfig"
source "board/nxp/imx94_orangebox/Kconfig"
source "board/nxp/imx95_evk/Kconfig"
source "board/nxp/imx95_frdm/Kconfig"
source "board/nxp/imx952_evk/Kconfig"
source "board/nxp/imx952_frdm/Kconfig"
source "board/toradex/smarc-imx95/Kconfig"
source "board/toradex/verdin-imx95/Kconfig"

endif
```

## board/congatec/conga-smx95/Kconfig
```kconfig
if TARGET_CONGA_SMX95

config SYS_BOARD
    default "conga-smx95"

config SYS_VENDOR
    default "congatec"

config SYS_CONFIG_NAME
    default "conga_smx95"

endif
```

## board/freescale/imx91_flux/Kconfig
```kconfig
if TARGET_IMX91_9X9_FLUX || TARGET_IMX91_9X9_FLUX_V3

config SYS_BOARD
	default "imx91_flux"

config SYS_VENDOR
	default "freescale"

config SYS_CONFIG_NAME
	default "imx91_flux"

endif
```

## board/freescale/imx952_evk/Kconfig
```kconfig
if TARGET_IMX952_EVK

config SYS_BOARD
	default "imx952_evk"

config SYS_VENDOR
	default "freescale"

config SYS_CONFIG_NAME
	default "imx952_evk"

endif
```

## board/nxp/imx93_frdm/Kconfig
```kconfig
if TARGET_IMX93_11X11_FRDM ||TARGET_IMX93W_FRDM

config SYS_BOARD
	default "imx93_frdm"

config SYS_VENDOR
	default "nxp"

config SYS_CONFIG_NAME
	default "imx93_frdm"

endif
```

## board/nxp/imx952_evk/Kconfig
```kconfig
if TARGET_IMX952_EVK || TARGET_IMX937_EVK

config SYS_BOARD
	default "imx952_evk"

config SYS_VENDOR
	default "nxp"

config SYS_CONFIG_NAME
	default "imx952_evk"

config IMX952_ENETC_SGMII
	bool "Enable ENETC SGMII 1G mode support"
	default n

endif
```

## board/nxp/imx952_frdm/Kconfig
```kconfig
if TARGET_IMX952_FRDM || TARGET_IMX937_FRDM

config SYS_BOARD
	default "imx952_frdm"

config SYS_VENDOR
	default "nxp"

config SYS_CONFIG_NAME
	default "imx952_frdm"

endif
```

## configs/conga_smx95_defconfig
```kconfig
CONFIG_ARM=y
CONFIG_ARCH_IMX95=y
CONFIG_TARGET_CONGA_SMX95=y

CONFIG_DEFAULT_DEVICE_TREE="imx95-19x19-evk"

CONFIG_SPL=y
CONFIG_SPL_LIBCOMMON_SUPPORT=y
CONFIG_SPL_LIBGENERIC_SUPPORT=y

CONFIG_FSPI=y
CONFIG_DM_SPI_FLASH=y

CONFIG_MMC=y
CONFIG_DM_MMC=y

CONFIG_USB=y
CONFIG_DM_USB=y

CONFIG_NET=y
CONFIG_PHYLIB=y

CONFIG_CMD_BOOTI=y
CONFIG_CMD_MMC=y
CONFIG_CMD_USB=y
CONFIG_CMD_NET=y

CONFIG_ENV_IS_IN_SPI_FLASH=y
```
