## arch/arm/mach-imx/imx8/Kconfig
```kconfig
if ARCH_IMX8

config AHAB_BOOT
	bool "Support i.MX8 AHAB features"
	imply CMD_DEKBLOB
	help
	  This option enables the support for AHAB secure boot.

config IMX_LOAD_HDMI_FIMRWARE_RX
	bool "Enable HDMI rx firmware loading"
	depends on ARCH_IMX8 || VIDEO_IMX_HDP_LOAD
	help
	  This enable the hdmi rx firmware loading. It depends on the "hdprx" command.

config IMX_LOAD_HDMI_FIMRWARE_TX
	bool "Enable HDMI tx firmware loading"
	depends on ARCH_IMX8 || VIDEO_IMX_HDP_LOAD
	help
	  This enable the hdmi tx firmware loading. It depends on the "hdp" command.

config IMX8
	bool
	select HAS_CAAM

config MU_BASE_SPL
	hex "MU base address used in SPL"
	default 0x5d1b0000
	help
	  SPL runs in EL3 mode, it use MU0_A to communicate with SCU.
	  So we could not reuse the one in dts which is for normal U-Boot.

config IMX8QM
	select IMX8
	select SUPPORT_SPL
	select SPL_RECOVER_DATA_SECTION if SPL
	bool

config IMX8QXP
	select IMX8
	select SUPPORT_SPL
	select SPL_RECOVER_DATA_SECTION if SPL
	bool

config IMX8DXL
	select IMX8
	select SUPPORT_SPL
	select SPL_RECOVER_DATA_SECTION if SPL
	bool

config SYS_SOC
	default "imx8"

config BOOTAUX_RESERVED_MEM_BASE
	hex "i.MX auxiliary core dram memory base"
	default 0

config BOOTAUX_RESERVED_MEM_SIZE
	hex "i.MX auxiliary core dram memory size"
	default 0

config PSCI_BOARD_REBOOT
	bool "Enable psci board reboot command"
	depends on ARM_PSCI_FW
	help
	  This is a optional command used to trigger system board reboot on imx8.

config SECURE_HEAP_BASE
	hex "secure heap base addr"
	default 0xe0000000

config SECURE_HEAP_SIZE
	hex "secure heap base size"
	default 0x10000000

config VPU_BOOT_BASE
	hex "vpu boot memory addr"
	default 0x96000000

config VPU_BOOT_SIZE
	hex "vpu boot memory size"
	default 0x2000000


choice
	prompt "i.MX8 board select"
	optional

config TARGET_APALIS_IMX8
	bool "Support Apalis iMX8 module"
	select BOARD_LATE_INIT
	select IMX8QM

config TARGET_COLIBRI_IMX8X
	bool "Support Colibri iMX8X module"
	select BINMAN
	select BOARD_LATE_INIT
	select IMX8QXP

config TARGET_DENEB
	bool "Support i.MX8QXP Capricorn Deneb board"
	select BINMAN
	select BOARD_LATE_INIT
	select FACTORYSET
	select IMX8QXP

config TARGET_GIEDI
	bool "Support i.MX8QXP Capricorn Giedi board"
	select BINMAN
	select BOARD_LATE_INIT
	select FACTORYSET
	select IMX8QXP

config TARGET_IMX8QM_MEK
	bool "Support i.MX8QM MEK board"
	select BOARD_LATE_INIT
	select IMX8QM
	select FSL_CAAM
	select FSL_BLOB
	select ARCH_MISC_INIT
	select SPL_CRYPTO if SPL

config TARGET_IMX8QM_LPDDR4_VAL
	bool "Support i.MX8QM lpddr4 validation board"
	select BOARD_LATE_INIT
	select IMX8QM

config TARGET_IMX8QM_DDR4_VAL
	bool "Support i.MX8QM ddr4 validation board"
	select BOARD_LATE_INIT
	select IMX8QM

config TARGET_CONGA_QMX8
	bool "Support congatec conga-QMX8 board"
	select BINMAN
	select BOARD_LATE_INIT
	select SUPPORT_SPL
	select IMX8QM

config TARGET_IMX8QM_ROM7720_A1
	bool "Support i.MX8QM ROM-7720-A1"
	select BINMAN
	select BOARD_LATE_INIT
	select SUPPORT_SPL
	select IMX8QM

config TARGET_IMX8QXP_MEK
	bool "Support i.MX8QXP MEK board"
	select BOARD_LATE_INIT
	select IMX8QXP
	select FSL_CAAM
	select FSL_BLOB
	select ARCH_MISC_INIT
	select SPL_CRYPTO if SPL

config TARGET_IMX8QM_MEK_A53_ONLY
        bool "Support i.MX8QM MEK board, cluster A53 only"
        select BOARD_LATE_INIT
        select IMX8QM

config TARGET_IMX8QM_MEK_A72_ONLY
        bool "Support i.MX8QM MEK board, cluster A72 only"
        select BOARD_LATE_INIT
        select IMX8QM

config TARGET_IMX8QXP_LPDDR4_VAL
	bool "Support i.MX8QXP lpddr4 validation board"
	select BOARD_LATE_INIT
	select IMX8QXP

config TARGET_IMX8QXP_DDR3_VAL
	bool "Support i.MX8QXP ddr3 validation board"
	select BOARD_LATE_INIT
	select IMX8QXP

config TARGET_IMX8X_17X17_VAL
	bool "Support i.MX8QXP/DX 17x17 validation board"
	select BOARD_LATE_INIT
	select IMX8QXP

config TARGET_IMX8DXL_PHANTOM_MEK
	bool "Support i.MX8DXL PHANTOM MEK board"
	select BOARD_LATE_INIT
	select IMX8QXP
	select FSL_CAAM
	select FSL_BLOB
	select ARCH_MISC_INIT
	select SPL_CRYPTO if SPL

config TARGET_IMX8DX_MEK
	bool "Support i.MX8DX MEK board"
	select BOARD_LATE_INIT
	select SUPPORT_SPL
	select IMX8QXP
	select FSL_CAAM
	select FSL_BLOB
	select ARCH_MISC_INIT
	select SPL_CRYPTO if SPL

config TARGET_IMX8DXL_EVK
	bool "Support i.MX8DXL EVK board"
	select BOARD_LATE_INIT
	select IMX8DXL
	select FSL_CAAM
	select FSL_BLOB
	select ARCH_MISC_INIT
	select SPL_CRYPTO if SPL

config TARGET_IMX8DXL_DDR3_EVK
	bool "Support i.MX8DXL EVK board"
	select BOARD_LATE_INIT
	select IMX8DXL
	select FSL_CAAM
	select FSL_BLOB
	select ARCH_MISC_INIT
	select SPL_CRYPTO if SPL

config TARGET_IMX8DXL_ORANGEBOX
	bool "Support i.MX8DXL OrangeBox board"
	select BOARD_LATE_INIT
	select IMX8DXL
	select FSL_CAAM
	select FSL_BLOB
	select ARCH_MISC_INIT
	select SPL_CRYPTO if SPL

endchoice

source "board/freescale/imx8qm_mek/Kconfig"
source "board/freescale/imx8qxp_mek/Kconfig"
source "board/congatec/cgtqmx8/Kconfig"
source "board/freescale/imx8qm_val/Kconfig"
source "board/freescale/imx8qxp_val/Kconfig"
source "board/freescale/imx8dxl_phantom_mek/Kconfig"
source "board/freescale/imx8dxl_evk/Kconfig"
source "board/freescale/imx8dxl_orangebox/Kconfig"
source "board/advantech/imx8qm_rom7720_a1/Kconfig"
source "board/toradex/apalis-imx8/Kconfig"
source "board/toradex/colibri-imx8x/Kconfig"
source "board/siemens/capricorn/Kconfig"

config SKIP_RESOURCE_CHECKING
	bool "Skip resource owner checking to kernel FDT nodes"
	help
	  By default the kernel FDT nodes are checked if belong to current partition.
	  Set the config to skip this checking.

config IMX_SNVS_SEC_SC
	bool "Support SNVS configuration"
	help
	  Allow to configure the SNVS via SCU API to configure tampers and secure
	  violation.

config IMX_SNVS_SEC_SC_AUTO
	bool "Support SNVS configuration command"
	depends on IMX_SNVS_SEC_SC
	help
	  This configuration will apply the selected configurations automatically
	  at boot.

endif
```

## arch/arm/mach-imx/imx8m/Kconfig
```kconfig
if ARCH_IMX8M

config IMX8M
	bool
	select HAS_CAAM
	select ROM_UNIFIED_SECTIONS

config IMX8MQ
	bool
	select IMX8M
	select ARMV8_SPL_EXCEPTION_VECTORS

config IMX8MM
	bool
	select IMX8M
	select ARMV8_SPL_EXCEPTION_VECTORS

config IMX8MN
	bool
	select IMX8M
	select ARMV8_SPL_EXCEPTION_VECTORS

config IMX8MP
	bool
	select IMX8M

config SYS_SOC
	default "imx8m"

config SECONDARY_BOOT_SECTOR_OFFSET
	hex "SD/MMC sector offset used for ROM secondary boot"
	default 0x0
	depends on IMX8MQ || IMX8MM
	help
	  Set the sector offset to non-zero value in SPL used for
	  secondary boot image. This value should be same as the
	  firstSectorNumber in secondary image table.

config SECURE_STICKY_BITS_LOCKUP
	bool "Enable workaround to fix sticky bits lock up issue"
	depends on IMX8MQ && IMX_HAB
	default y

config IMX_UNIQUE_ID
	hex "Enable workaround to fix sticky bits lock up issue"
	depends on IMX8MQ && IMX_HAB && !SECURE_STICKY_BITS_LOCKUP
	default 0x0

choice
	prompt  "NXP i.MX8M board select"
	optional

config TARGET_IMX8MQ_EVK
	bool "imx8mq_evk"
	select IMX8MQ
	select IMX8M_LPDDR4
	select FSL_CAAM
	select FSL_BLOB
	select MISC
	select SPL_CRYPTO_SUPPORT if SPL

config TARGET_IMX8MQ_PHANBELL
        bool "imx8mq_phanbell"
        select IMX8MQ
        select IMX8M_LPDDR4

config TARGET_IMX8MQ_DDR3L_VAL
	bool "imx8mq_ddr3l_val"
	select IMX8MQ

config TARGET_IMX8MQ_DDR4_VAL
	bool "imx8mq_ddr4_val"
	select IMX8MQ
	select IMX8M_DDR4

config TARGET_IMX8MM_DDR4_VAL
	bool "imx8mm DDR4 validation board"
	select IMX8MM
	select SUPPORT_SPL
	select IMX8M_DDR4

config TARGET_IMX8MM_DDR3L_VAL
	bool "imx8mm DDR3L validation board"
	select IMX8MM
	select SUPPORT_SPL
	select IMX8M_DDR3L

config TARGET_IMX8MM_EVK
	bool "imx8mm LPDDR4 EVK board"
	select IMX8MM
	select SUPPORT_SPL
	select IMX8M_LPDDR4
	select FSL_CAAM
	select FSL_BLOB
	select MISC
	select SPL_CRYPTO_SUPPORT if SPL

config TARGET_IMX8MM_VENICE
	bool "Support Gateworks Venice iMX8M Mini module"
	select IMX8MM
	select SUPPORT_SPL
	select IMX8M_LPDDR4

config TARGET_IMX8MM_EVK_QCA
	bool "imx8mm LPDDR4 EVK Legacy QCA WIFI board"
	select IMX8MM
	select SUPPORT_SPL
	select IMX8M_LPDDR4

config TARGET_IMX8MM_DDR4_EVK
	bool "imx8mm DDR4 EVK board"
	select IMX8MM
	select SUPPORT_SPL
	select IMX8M_DDR4
	select FSL_CAAM
	select FSL_BLOB
	select MISC
	select SPL_CRYPTO_SUPPORT if SPL

config TARGET_IMX8MN_EVK
	bool "imx8mn LPDDR4 EVK board"
	select IMX8MN
	select SUPPORT_SPL
	select IMX8M_LPDDR4
	select FSL_CAAM
	select FSL_BLOB
	select MISC
	select SPL_CRYPTO_SUPPORT if SPL

config TARGET_IMX8MN_DDR4_EVK
	bool "imx8mn DDR4 EVK board"
	select IMX8MN
	select SUPPORT_SPL
	select IMX8M_DDR4
	select FSL_CAAM
	select FSL_BLOB
	select MISC
	select SPL_CRYPTO_SUPPORT if SPL

config TARGET_IMX8MN_DDR3_EVK
	bool "imx8mn 11x11 DDR3 EVK board"
	select IMX8MN
	select SUPPORT_SPL
	select IMX8M_DDR3L
	select FSL_CAAM
	select FSL_BLOB
	select MISC
	select SPL_CRYPTO_SUPPORT if SPL

config TARGET_IMX8MP_EVK
	bool "imx8mp LPDDR4 EVK board"
	select IMX8MP
	select SUPPORT_SPL
	select IMX8M_LPDDR4
	select FSL_CAAM
	select FSL_BLOB
	select MISC
	select SPL_CRYPTO_SUPPORT if SPL

config TARGET_PICO_IMX8MQ
	bool "Support Technexion Pico iMX8MQ"
	select IMX8MQ
	select IMX8M_LPDDR4

config TARGET_IMX8MP_DDR4_EVK
	bool "imx8mp DDR4 EVK board"
	select IMX8MP
	select SUPPORT_SPL
	select IMX8M_DDR4
	select FSL_CAAM
	select FSL_BLOB
	select MISC
	select SPL_CRYPTO_SUPPORT if SPL

config TARGET_VERDIN_IMX8MM
       bool "Support Toradex Verdin iMX8M Mini module"
       select IMX8MM
       select SUPPORT_SPL
       select IMX8M_LPDDR4

config TARGET_IMX8MM_BEACON
	bool "imx8mm Beacon Embedded devkit"
	select IMX8MM
	select SUPPORT_SPL
	select IMX8M_LPDDR4

config TARGET_IMX8MN_BEACON
	bool "imx8mn Beacon Embedded devkit"
	select IMX8MN
	select SUPPORT_SPL
	select IMX8M_LPDDR4

config TARGET_PHYCORE_IMX8MM
	bool "PHYTEC PHYCORE i.MX8MM"
	select IMX8MM
        select SUPPORT_SPL
	select IMX8M_LPDDR4

config TARGET_PHYCORE_IMX8MP
	bool "PHYTEC PHYCORE i.MX8MP"
	select IMX8MP
        select SUPPORT_SPL
	select IMX8M_LPDDR4
endchoice

source "board/freescale/imx8mq_evk/Kconfig"
source "board/freescale/imx8mq_val/Kconfig"
source "board/freescale/imx8mm_evk/Kconfig"
source "board/freescale/imx8mm_val/Kconfig"
source "board/freescale/imx8mn_evk/Kconfig"
source "board/freescale/imx8mp_evk/Kconfig"
source "board/gateworks/venice/Kconfig"
source "board/google/imx8mq_phanbell/Kconfig"
source "board/technexion/pico-imx8mq/Kconfig"
source "board/toradex/verdin-imx8mm/Kconfig"
source "board/beacon/imx8mm/Kconfig"
source "board/beacon/imx8mn/Kconfig"
source "board/phytec/phycore_imx8mm/Kconfig"
source "board/phytec/phycore_imx8mp/Kconfig"

endif
```

## arch/arm/mach-imx/imx8ulp/Kconfig
```kconfig
if ARCH_IMX8ULP

config AHAB_BOOT
	bool "Support i.MX8ULP AHAB features"
	help
	  This option enables the support for AHAB secure boot.

config IMX8ULP
	bool

config SYS_SOC
	default "imx8ulp"

config IMX8ULP_ND_MODE
	bool "i.MX8ULP Low Driver Mode"

config IMX8ULP_DRAM_AUTO_LP
	bool "i.MX8ULP DDR Auto Low Power Interface"
	default n

config IMX8ULP_FIXED_OP_RANGE
        bool "i.MX8ULP APD Port fixed operation range"
        default n

config IMX8ULP_UPOWER_OSC
	bool "i.MX8ULP uPower OSC mode"
	default n

config IMX8ULP_UPOWER_OSC_MODE
	hex "uPower OSC mode: 0x0 - low; 0x1 - high"
	depends on IMX8ULP_UPOWER_OSC
	default 0x0
	help
	  uPower OSC mode config options
	  0x0 - osc low mode  - 16Mhz
	  0x1 - osc high mode - 64Mhz

choice
	prompt "i.MX8ULP board select"
	optional

config TARGET_IMX8ULP_EVK
	bool "imx8ulp_evk"
	select IMX8ULP
	select SUPPORT_SPL
	select IMX8ULP_DRAM
	select FSL_CAAM
	select FSL_BLOB
	select ARCH_MISC_INIT
	select SPL_CRYPTO if SPL

config TARGET_IMX8ULP_9X9_EVK
	bool "imx8ulp_9x9_evk"
	select IMX8ULP
	select SUPPORT_SPL
	select IMX8ULP_DRAM
	select FSL_CAAM
	select FSL_BLOB
	select MISC
	select ARCH_MISC_INIT
	select SPL_CRYPTO if SPL

config TARGET_IMX8ULP_WATCH
	bool "imx8ulp_watch"
	select IMX8ULP
	select SUPPORT_SPL
	select IMX8ULP_DRAM
	select FSL_CAAM
	select FSL_BLOB
	select ARCH_MISC_INIT
	select SPL_CRYPTO if SPL

endchoice

source "board/freescale/imx8ulp_evk/Kconfig"
source "board/freescale/imx8ulp_watch/Kconfig"

endif
```

## arch/arm/mach-imx/mx7/Kconfig
```kconfig
if ARCH_MX7

config MX7
	bool
	default y
	select ARCH_SUPPORT_PSCI
	select CPU_V7_HAS_NONSEC
	select CPU_V7_HAS_VIRT
	select IOMUX_LPSR
	select ROM_UNIFIED_SECTIONS
	select SYSCOUNTER_TIMER
	imply CMD_FUSE

config MX7D
	bool
	select HAS_CAAM
	select ROM_UNIFIED_SECTIONS
	imply CMD_FUSE

config TEXT_BASE
	default 0x87800000

config SPL_TEXT_BASE
	depends on SPL
	default 0x00912000

config OPTEE_TZDRAM_SIZE
	hex "Amount of Trust-Zone RAM for the OPTEE image"
	default 0x0000000
	depends on OPTEE_LIB
	help
	  The size of pre-allocated Trust Zone DRAM to allocate for the OPTEE
	  runtime.

config IMX_TAMPER
	bool "Enable commands for SNVS tamper pin configuration and test"
	help
	  Set "Y" to enable the tamper commands

choice
	prompt "MX7 board select"
	optional

config TARGET_CL_SOM_IMX7
	bool "CL-SOM-iMX7"
	select DM
	select DM_THERMAL
	select MX7D
	select SUPPORT_SPL
	imply CMD_DM

config TARGET_IMX7_CM
	bool "Ronetix iMX7-CM"
	select BOARD_LATE_INIT
	select DM
	select DM_THERMAL
	select MX7D
	select SUPPORT_SPL
	imply CMD_DM

config TARGET_MEERKAT96
	bool "NovTech Meerkat96 board"
	select BOARD_LATE_INIT
	select DM
	select DM_SERIAL
	select DM_THERMAL
	select MX7D
	imply CMD_DM

config TARGET_MX7DSABRESD
	bool "mx7dsabresd"
	select BOARD_LATE_INIT
	select DM
	select DM_THERMAL
	select MX7D
	imply CMD_DM
	select FSL_CAAM
	select FSL_BLOB

config TARGET_MX7D_12X12_LPDDR3_VAL
	bool "Support mx7d_12x12_lpddr3_val"
	select BOARD_LATE_INIT
	select MX7D
	select DM
	select DM_THERMAL
	imply CMD_DM

config TARGET_MX7D_12X12_DDR3_VAL
	bool "Support mx7d_12x12_ddr3_val"
	select BOARD_LATE_INIT
	select MX7D
	select DM
	select DM_THERMAL
	imply CMD_DM

config TARGET_MX7D_19X19_DDR3_VAL
	bool "Support mx7d_19x19_ddr3_val"
	select BOARD_LATE_INIT
	select MX7D
	select DM
	select DM_THERMAL
	imply CMD_DM

config TARGET_MX7D_19X19_LPDDR3_VAL
	bool "Support mx7d_19x19_lpddr3_val"
	select BOARD_LATE_INIT
	select MX7D
	select DM
	select DM_THERMAL
	imply CMD_DM

config TARGET_MX7D_19X19_LPDDR2_VAL
	bool "Support mx7d_19x19_lpddr2_val"
	select BOARD_LATE_INIT
	select MX7D
	select DM
	select DM_THERMAL
	imply CMD_DM

config TARGET_PICO_IMX7D
	bool "pico-imx7d"
	select BOARD_LATE_INIT
	select DM
	select DM_THERMAL
	select MX7D
	select SUPPORT_SPL
	imply CMD_DM

config TARGET_SMEGW01
	bool "smegw01"
	select BOARD_LATE_INIT
	select DM
	select DM_THERMAL
	select MX7D
	imply CMD_DM

config TARGET_WARP7
	bool "warp7"
	select BOARD_LATE_INIT
	select DM
	select DM_THERMAL
	select MX7D
	imply CMD_DM

config TARGET_COLIBRI_IMX7
	bool "Support Colibri iMX7S/iMX7D modules"
	select DM
	select DM_SERIAL
	select DM_THERMAL
	select MX7D
	imply CMD_DM

endchoice

config SYS_SOC
	default "mx7"

source "board/compulab/cl-som-imx7/Kconfig"
source "board/ronetix/imx7-cm/Kconfig"
source "board/freescale/mx7dsabresd/Kconfig"
source "board/freescale/mx7d_12x12_lpddr3_val/Kconfig"
source "board/freescale/mx7d_12x12_ddr3_val/Kconfig"
source "board/freescale/mx7d_19x19_ddr3_val/Kconfig"
source "board/freescale/mx7d_19x19_lpddr3_val/Kconfig"
source "board/novtech/meerkat96/Kconfig"
source "board/storopack/smegw01/Kconfig"
source "board/technexion/pico-imx7d/Kconfig"
source "board/toradex/colibri_imx7/Kconfig"
source "board/warp7/Kconfig"

endif
```
