## arch/arm/mach-imx/mx7ulp/Kconfig
```kconfig
if ARCH_MX7ULP

config SYS_SOC
	default "mx7ulp"

config LDO_ENABLED_MODE
	bool "i.MX7ULP LDO Enabled Mode"
	help
	  Select this option to enable the PMC1 LDO.

config MX7ULP
	select HAS_CAAM
	bool

config IMX_M4_BIND
	bool "Bind ULP M4 image to final u-boot"
	help
	  Select this to bind a ULP M4 image to final u-boot image
	  User needs put the M4 image ulp_m4.bin under u-boot directory

choice
	prompt "MX7ULP board select"
	optional

config TARGET_MX7ULP_COM
	bool "Support MX7ULP COM board"
	select MX7ULP
	select SYS_ARCH_TIMER
config TARGET_MX7ULP_10X10_VAL
	bool "Support mx7ulp 10x10 validation board"
	select SYS_ARCH_TIMER
	select MX7ULP

config TARGET_MX7ULP_14X14_VAL
	bool "Support mx7ulp 14x14 validation board"
	select SYS_ARCH_TIMER
	select MX7ULP

config TARGET_MX7ULP_EVK
	bool "Support mx7ulp EVK board"
	select MX7ULP
	select SYS_ARCH_TIMER

endchoice

source "board/ea/mx7ulp_com/Kconfig"
source "board/freescale/mx7ulp_val/Kconfig"
source "board/freescale/mx7ulp_evk/Kconfig"

endif
```

## arch/arm/mach-s32/Kconfig
```kconfig
# SPDX-License-Identifier: GPL-2.0+
# Copyright 2020 NXP

config MKIMAGE_T
	string
	default "s32v234image"
	depends on ARCH_S32V234
```

## board/freescale/Kconfig
```kconfig
if TARGET_S32V234EVB ||		\
   TARGET_S32V234PCIE

source "board/freescale/s32v234evb/Kconfig"

source "board/freescale/s32v234pcie/Kconfig"

config SYS_VENDOR
	string
	default "freescale"

endif
```

## board/freescale/common/Kconfig
```kconfig
if !ARCH_IMX8M && !ARCH_IMX8

config CHAIN_OF_TRUST
	depends on !FIT_SIGNATURE && SECURE_BOOT
	imply CMD_BLOB
	select FSL_CAAM
	bool
	default y

endif

config USB_TCPC
	bool "USB Typec port controller simple driver"
	default n
	help
	  Enable USB type-c port controller (TCPC) driver
```

## board/freescale/imx8dxl_evk/Kconfig
```kconfig
if  TARGET_IMX8DXL_EVK || TARGET_IMX8DXL_DDR3_EVK

config SYS_BOARD
	default "imx8dxl_evk"

config SYS_VENDOR
	default "freescale"

config SYS_CONFIG_NAME
	default "imx8dxl_evk"

source "board/freescale/common/Kconfig"

endif
```

## board/freescale/imx8dxl_orangebox/Kconfig
```kconfig
if TARGET_IMX8DXL_ORANGEBOX

config SYS_BOARD
	default "imx8dxl_orangebox"

config SYS_VENDOR
	default "freescale"

config SYS_CONFIG_NAME
	default "imx8dxl_orangebox"

config IMX_CONFIG
	default "board/freescale/imx8dxl_orangebox/imximage.cfg"

endif
```

## board/freescale/imx8dxl_phantom_mek/Kconfig
```kconfig
if  TARGET_IMX8DXL_PHANTOM_MEK

config SYS_BOARD
	default "imx8dxl_phantom_mek"

config SYS_VENDOR
	default "freescale"

config SYS_CONFIG_NAME
	default "imx8dxl_phantom_mek"

source "board/freescale/common/Kconfig"

endif
```

## board/freescale/imx8mm_ab2/Kconfig
```kconfig
if TARGET_IMX8MM_AB2 || TARGET_IMX8MM_DDR4_AB2 || \
	TARGET_IMX8MN_AB2 || TARGET_IMX8MN_DDR4_AB2 || \
	TARGET_IMX8MN_DDR3L_AB2

config SYS_BOARD
	default "imx8mm_ab2"

config SYS_VENDOR
	default "freescale"

if IMX8MM
config SYS_CONFIG_NAME
	default "imx8mm_ab2"

config IMX_CONFIG
	default "board/freescale/imx8mm_ab2/imximage-8mm.cfg"
endif

if IMX8MN
config SYS_CONFIG_NAME
	default "imx8mn_ab2"

config IMX_CONFIG
	default "board/freescale/imx8mm_ab2/imximage-8mn.cfg"
endif

source "board/freescale/common/Kconfig"

endif
```

## board/freescale/imx8mm_evk/Kconfig
```kconfig
if TARGET_IMX8MM_EVK || TARGET_IMX8MM_DDR4_EVK

config SYS_BOARD
	default "imx8mm_evk"

config SYS_VENDOR
	default "freescale"

config SYS_CONFIG_NAME
	default "imx8mm_evk"

config IMX_CONFIG
	default "board/freescale/imx8mm_evk/imximage-8mm.cfg"

config IMX8M_1G_MEMORY
	bool "imx8m 1GB memory size"

source "board/freescale/common/Kconfig"

endif
```

## board/freescale/imx8mm_val/Kconfig
```kconfig
 if TARGET_IMX8MM_DDR4_VAL || TARGET_IMX8MM_DDR3L_VAL

config SYS_BOARD
	default "imx8mm_val"

config SYS_VENDOR
	default "freescale"

config SYS_CONFIG_NAME
	default "imx8mm_val"

config IMX_CONFIG
	default "board/freescale/imx8mm_val/imximage-8mm.cfg"

endif
```

## board/freescale/imx8mn_evk/Kconfig
```kconfig
if TARGET_IMX8MN_EVK

config SYS_BOARD
	default "imx8mn_evk"

config SYS_VENDOR
	default "freescale"

config SYS_CONFIG_NAME
	default "imx8mn_evk"

config IMX8MN_FORCE_NOM_SOC
	bool "Force to use nominal mode for SOC and ARM"
	default n

source "board/freescale/common/Kconfig"

endif
```

## board/freescale/imx8mp_evk/Kconfig
```kconfig
if TARGET_IMX8MP_EVK || TARGET_IMX8MP_DDR4_EVK

config SYS_BOARD
	default "imx8mp_evk"

config SYS_VENDOR
	default "freescale"

config SYS_CONFIG_NAME
	default "imx8mp_evk"

config IMX_CONFIG
	default "board/freescale/imx8mp_evk/imximage-8mp-lpddr4.cfg"

config IMX8MP_GP5_LOCK_UPDATE
	bool "Enable burn GP5_LOCK fuse at boot"
	help
	  Select to check the GP5_LOCK fuse and burn it to WP+OP

endif
```
