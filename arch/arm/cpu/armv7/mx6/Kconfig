## arch/arm/cpu/armv7/mx6/Kconfig
```kconfig
if ARCH_MX6

config MX6
	bool
	default y

config MX6D
	bool

config MX6DL
	bool

config MX6Q
	bool

config MX6QDL
	bool

config MX6S
	bool

config MX6SL
	bool

config MX6SX
	bool

config MX6UL
	bool

config MX6ULL
	bool
	select MX6UL

choice
	prompt "MX6 board select"

config TARGET_MX6ULL_DDR3_ARM2
	bool "Support mx6ull_ddr3_arm2"
	select CPU_V7
	select MX6ULL

config TARGET_SECOMX6
	bool "Support secomx6 boards"
	select CPU_V7

endchoice

config SYS_SOC
	default "mx6"

source "board/seco/Kconfig"
source "board/freescale/mx6ull_ddr3_arm2/Kconfig"

endif
```

## arch/arm/cpu/armv7/mx7/Kconfig
```kconfig
if ARCH_MX7

config MX7
	bool
	select ROM_UNIFIED_SECTIONS
	select CPU_V7_HAS_VIRT
	select CPU_V7_HAS_NONSEC
	select ARCH_SUPPORT_PSCI
	default y

config MX7D
	select ROM_UNIFIED_SECTIONS
	bool

choice
	prompt "MX7 board select"
	optional

config TARGET_MX7DSABRESD
	bool "mx7dsabresd"
	select BOARD_LATE_INIT
	select MX7D
	select DM
	select DM_THERMAL

config TARGET_MX7D_12X12_LPDDR3_ARM2
	bool "Support mx7d_12x12_lpddr3_arm2"
	select BOARD_LATE_INIT
	select MX7D
	select DM
	select DM_THERMAL

config TARGET_PICO_IMX7D
	bool "Support pico-imx7d"
	select MX7D
	select DM
	select DM_THERMAL

config TARGET_MULTA_IMX7D
	bool "Support multa-imx7d"
	select MX7D
	select DM
	select DM_THERMAL

config TARGET_MX7D_12X12_DDR3_ARM2
	bool "Support mx7d_12x12_ddr3_arm2"
	select BOARD_LATE_INIT
	select MX7D
	select DM
	select DM_THERMAL

config TARGET_MX7D_19X19_DDR3_ARM2
	bool "Support mx7d_19x19_ddr3_arm2"
	select BOARD_LATE_INIT
	select MX7D
	select DM
	select DM_THERMAL

config TARGET_MX7D_19X19_LPDDR3_ARM2
	bool "Support mx7d_19x19_ddr3_arm2"
	select BOARD_LATE_INIT
	select MX7D
	select DM
	select DM_THERMAL

config TARGET_MX7D_19X19_LPDDR2_ARM2
	bool "Support mx7d_19x19_ddr3_arm2"
	select BOARD_LATE_INIT
	select MX7D
	select DM
	select DM_THERMAL

config TARGET_WARP7
	bool "warp7"
	select BOARD_LATE_INIT
	select MX7D
	select DM
	select DM_THERMAL

config TARGET_COLIBRI_IMX7
	bool "Support Colibri iMX7S/iMX7D modules"
	select BOARD_LATE_INIT
	select DM
	select DM_SERIAL
	select DM_THERMAL

endchoice

config SYS_SOC
	default "mx7"

source "board/freescale/mx7dsabresd/Kconfig"
source "board/freescale/mx7d_12x12_lpddr3_arm2/Kconfig"
source "board/freescale/mx7d_12x12_ddr3_arm2/Kconfig"
source "board/freescale/mx7d_19x19_ddr3_arm2/Kconfig"
source "board/freescale/mx7d_19x19_lpddr3_arm2/Kconfig"
source "board/freescale/pico-imx7d/Kconfig"
source "board/freescale/multa-imx7d/Kconfig"
source "board/toradex/colibri_imx7/Kconfig"
source "board/warp7/Kconfig"

endif
```

## arch/arm/cpu/armv7/mx7ulp/Kconfig
```kconfig
if ARCH_MX7ULP

config SYS_SOC
	default "mx7ulp"

config IMX_M4_BIND
	bool "Bind ULP M4 image to final u-boot"
	help
	  Select this to bind a ULP M4 image to final u-boot image
	  User needs put the M4 image ulp_m4.bin under u-boot directory

config MX7ULP
	bool

choice
	prompt "MX7ULP board select"
	optional

config TARGET_MX7ULP_10X10_ARM2
	bool "Support mx7ulp 10x10 validation board"
	select MX7ULP

config TARGET_MX7ULP_14X14_ARM2
	bool "Support mx7ulp 14x14 validation board"
	select MX7ULP

config TARGET_MX7ULP_EVK
        bool "Support mx7ulp EVK board"
	select MX7ULP

endchoice

source "board/freescale/mx7ulp_arm2/Kconfig"
source "board/freescale/mx7ulp_evk/Kconfig"

endif
```

## arch/arm/cpu/armv8/crypto/Kconfig
```kconfig
if ARM64

config CRYPTO_SHA2_ARM64_CE
        tristate "SHA-224/SHA-256 digest algorithm (ARMv8 Crypto Extensions)"

endif
```

## arch/arm/cpu/armv8/imx8/Kconfig
```kconfig
if ARCH_IMX8

config HAVE_SC_FIRMWARE
	bool
	help
	  Have SCU on the SoC

config IMX_SMMU
	bool "Enable SMMU on i.MX8"
	help
	  Enable the SMMU for peripherals on i.MX8

config IMX8
	bool
	default y

config IMX8QM
	bool
	select HAVE_SC_FIRMWARE

config IMX8QXP
	bool
	select HAVE_SC_FIRMWARE

config SYS_SOC
	default "imx8"

endif
```

## arch/arm/cpu/armv8/imx8m/Kconfig
```kconfig
if ARCH_IMX8M

config IMX8M
        bool
        select ROM_UNIFIED_SECTIONS

config IMX8MQ
	bool
	select IMX8M

config IMX8MM
	bool
	select IMX8M

choice
	prompt	"NXP i.MX8M board select"
	optional

config TARGET_IMX8MQ_EVK
	bool "imx8mq_evk"
	select IMX8MQ
	select SUPPORT_SPL

config TARGET_IMX8MQ_PHANBELL
	bool "imx8mq_phanbell"
	select IMX8MQ
	select SUPPORT_SPL

config TARGET_IMX8MQ_PHANBELL
	bool "imx8mq_phanbell"
	select IMX8M
	select SUPPORT_SPL

config TARGET_IMX8MQ_DDR3L_ARM2
	bool "imx8mq_ddr3l_arm2"
	select IMX8MQ
	select SUPPORT_SPL

config TARGET_IMX8MQ_DDR4_ARM2
	bool "imx8mq_ddr4_arm2"
	select IMX8MQ
	select SUPPORT_SPL

config TARGET_IMX8MM_DDR4_VAL
	bool "imx8mm validation board"
	select IMX8MM
	select SUPPORT_SPL

config TARGET_IMX8MM_EVK
	bool "imx8mm evk"
	select IMX8MM
	select SUPPORT_SPL
	select IMX8M_LPDDR4

endchoice

config SYS_SOC
	default "imx8m"

source "board/freescale/imx8mq_phanbell/Kconfig"
source "board/freescale/imx8mq_evk/Kconfig"
source "board/freescale/imx8mq_arm2/Kconfig"
source "board/freescale/imx8mm_evk/Kconfig"
source "board/freescale/imx8mm_val/Kconfig"

endif
```

## arch/arm/cpu/armv8/s32v234/Kconfig
```kconfig
if ARCH_S32V234

config SYS_VENDOR
	string
	default "freescale"

config SYS_SOC
	string
	default "s32v234"

config BAUDRATE
	int "Serial baudrate"
	default 115200

choice
	prompt "Select S32V234 Target Board Support"
	default TARGET_S32V234EVB
	help
	  S32V234 Target Board Selection.

config TARGET_S32V234EVB
	bool "Support s32v234evb"
	select SYS_FSL_ERRATUM_ESDHC111
	help
	  S32V Evaluation System for high-performance, safe computation-intensive
	  front vision, surround vision and sensor fusion applications.

config TARGET_S32V234PCIE
	bool "Support s32v234pcie"
	help
	  S32V234 board with PCIe Edge connector.

endchoice

if TARGET_S32V234EVB

choice
	prompt "S32V234EVB Board Family Member"
	default S32V234EVB_29288
	help
	  S32V234EVB Board Family Members.
	  Default selection is S32V234EVB_29288.

config S32V234EVB_28899
	bool "S32V234EVB_28899"
	help
	  First S32V234EVB generation.

config S32V234EVB_29288
	bool "S32V234EVB_29288"
	help
	  Second S32V234EVB generation.

endchoice

endif

choice
	prompt "Select DDR type"
	default S32V234_LPDDR2
	help
	  S32V234 DDR Configuration.
	  At this point, only Micron LPDDR2 is supported.

config S32V234_LPDDR2
	bool "LPDDR2 Support"
	help
	  Enable the support for Micron LPDDR2,
	  2×32-bit, up to 1066 MHz data rate, 2×1 GB addressable.

config S32V234_DDR3
	bool "DDR3 Support"
	help
	  Enable the support for Micron DDR3,
	  2×32-bit, up to 1066 MHz data rate, 2×1 GB addressable.

endchoice

config DDR_HANDSHAKE_AT_RESET
	bool "Enable DDR handshake"
	default y
	help
	  Enable DDR handshake after functional reset.
	  Execute additional checks in case of a functional reset.

source "board/freescale/s32v234evb/Kconfig"
source "board/freescale/s32v234pcie/Kconfig"

endif
```

## arch/arm/imx-common/Kconfig
```kconfig
config IMX_CONFIG
	string

config IMX_OPTEE
	bool "Support OP-TEE"
	help
	 Enable support for OP-TEE

config GPT_TIMER
	bool "Using i.MX GPT timer as system tick timer"
	depends on ARCH_MX6 || ARCH_MX7
	help
	  Enable GPT timer driver for system tick timer on i.MX6 and 
	  i.MX7.

config ROM_UNIFIED_SECTIONS
	bool

config IMX_RDC
	bool "i.MX Resource domain controller driver"
	depends on ARCH_MX6 || ARCH_MX7
	help
	  i.MX Resource domain controller is used to assign masters
	  and peripherals to differet domains. This can be used to
	  isolate resources.

config IMX_BOOTAUX
	bool "Support boot auxiliary core"
	depends on ARCH_MX7 || ARCH_MX6 || ARCH_IMX8
	help
	  bootaux [addr] to boot auxiliary core.

config USE_IMXIMG_PLUGIN
	bool "Use imximage plugin code"
	depends on ARCH_MX7 || ARCH_MX6 || ARCH_MX7ULP
	help
	  i.MX6/7 supports DCD and Plugin. Enable this configuration
	  to use Plugin, otherwise DCD will be used.

config SECURE_BOOT
	bool "Support i.MX HAB features"
	depends on ARCH_MX7 || ARCH_MX6 || ARCH_MX5 || ARCH_IMX8M
	select FSL_CAAM if !MX6ULL && !MX6SLL && !MX6SL && !IMX8M
	help
	  This option enables the support for secure boot (HAB).
	  See doc/README.mxc_hab for more details.

config FSL_MFGPROT
	bool "Support the 'mfgprot' command"
	depends on SECURE_BOOT && ARCH_MX7
	help
	  This option enables the manufacturing protection command
	  which can be used has a protection feature for Manufacturing
	  process. With this tool is possible to authenticate the
	  chip to the OEM's server.

config DBG_MONITOR
	bool "Enable the AXI debug monitor"
	depends on ARCH_MX6 || ARCH_MX7
	help
	  This option enables the debug monitor which prints out last 
	  failed AXI access info when system reboot is caused by AXI 
	  access failure.

config IMX_M4_BIND
	bool "Bind ULP M4 image to final u-boot"
	depends on ARCH_MX7ULP
	help
	  Select this to bind a ULP M4 image to final u-boot image
	  User needs put the M4 image ulp_m4.bin under u-boot directory

config IMX_TRUSTY_OS
	bool "Support Trusty OS related feature"
	depends on ARCH_MX6 || ARCH_MX7 || ARCH_IMX8 || ARCH_IMX8M
	select SYS_ARM_CACHE_WRITEALLOC

config SYS_ARM_CACHE_WRITEALLOC
	bool "support cache write alloc"
```
