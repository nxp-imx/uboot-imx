// SPDX-License-Identifier: GPL-2.0+
/*
 * Copyright 2020 NXP
 */

#include "imx8mn-evk.dts"
#include "imx8mn-ab2.dtsi"

/ {
	model = "NXP i.MX8MNano LPDDR4 Audio board 2.0";
	compatible = "fsl,imx8mn-ab2", "fsl,imx8mn";
};
