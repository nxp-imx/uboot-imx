/*
 * Copyright (C) 2018 NXP.
 *
 * This program is free software; you can redistribute it and/or modify
 * it under the terms of the GNU General Public License version 2 as
 * published by the Free Software Foundation.
 */

#include "imx6ull-14x14-evk.dts"

/ {
	model = "Freescale i.MX6 ULZ 14x14 EVK Board";
	compatible = "fsl,imx6ulz-14x14-evk", "fsl,imx6ull";

	backlight {
		status = "disabled";
	};

	pxp_v4l2 {
		status = "disabled";
	};
};
