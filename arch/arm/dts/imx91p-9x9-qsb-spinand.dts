// SPDX-License-Identifier: (GPL-2.0+ OR MIT)
/*
 * Copyright 2023 NXP
 */

#include "imx91p-9x9-qsb-ontat-wvga-panel.dts"

&flexspi1 {
	flash1: mt29f4g01abbfd12@0 {
		reg = <0>;
		#address-cells = <1>;
		#size-cells = <1>;
		compatible = "spi-nand";
		spi-max-frequency = <80000000>;
		spi-tx-bus-width = <4>;
		spi-rx-bus-width = <4>;
	};
};

/delete-node/ &flash0;
