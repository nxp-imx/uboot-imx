// SPDX-License-Identifier: (GPL-2.0+ OR MIT)
/*
 * Copyright 2020 NXP
 */

#include "imx8mm-evk.dts"
#include "imx8mm-ab2.dtsi"

/ {
	model = "NXP i.MX8MM Audio board 2.0";
	compatible = "fsl,imx8mm-ab2", "fsl,imx8mm";
};
