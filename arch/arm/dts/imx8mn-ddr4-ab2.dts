// SPDX-License-Identifier: (GPL-2.0+ OR MIT)
/*
 * Copyright 2020 NXP
 */

#include "imx8mn-ddr4-evk.dts"
#include "imx8mn-ab2.dtsi"

/ {
	model = "NXP i.MX8MNano DDR4 Audio board 2.0";
	compatible = "fsl,imx8mn-ab2", "fsl,imx8mn";
};
