// SPDX-License-Identifier: (GPL-2.0+ OR MIT)
/*
 * Copyright 2026 NXP
 */

/dts-v1/;

#include "imx937.dtsi"
#include "imx952-frdm.dtsi"

/ {
	model = "NXP i.MX937 FRDM board";
	compatible = "fsl,imx937-frdm", "fsl,imx937";
};

/delete-node/ &pcal6416;

&lpi2c2 {
	status = "okay";

	pcal6416: gpio@21 {
		compatible = "nxp,pcal6416";
		#gpio-cells = <2>;
		gpio-controller;
		reg = <0x21>;
		interrupt-controller;
		#interrupt-cells = <2>;
		interrupt-parent = <&gpio5>;
		interrupts = <14 IRQ_TYPE_LEVEL_LOW>;
		pinctrl-names = "default";
		pinctrl-0 = <&pinctrl_pcal6416>;
		vcc-supply = <&reg_3p3v>;
	};
};
